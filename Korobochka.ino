#define HW_CDC_ON_BOOT = TRUE

#include<Adafruit_GFX.h>
#include<Adafruit_SSD1306.h>
#include <Adafruit_MLX90614.h>
#include "SPIFFS.h"
#include <FS.h>
//#include "GyverButton.h"
//#include <Fonts/FreeMonoOblique12pt7b.h>
#include <EEPROM.h>

//#include<Vector.h>
#include <WiFi.h>
#include <WiFiClient.h>
#include <WebServer.h>
//#include <ESPmDNS.h>
//#include <WiFiUdp.h>
#include <ArduinoOTA.h>
#include <HTTPClient.h>
#include <HTTPUpdate.h>
#include <Fonts/Picopixel.h>
#include "digital.h"
#include <BleKeyboard.h>
//#include <ArduinoJson.h>
#include <time.h>

String ssid = "spynet-2.4g";
String password = "MW9pDbkK";



/*
  #include <WebSerial.h>
  #include <WiFi.h>
  #include <AsyncTCP.h>
  #include <ESPAsyncWebServer.h>
  #include <AsyncElegantOTA.h>

  AsyncWebServer server(80);

  const char* APssid = "KorobochkaWiFi";
  const char* APpassword = "12345678";
*/

#define BTN 0

#define APPS 17  // Для 11 приложений на Korobochka

#define KEYRS 4
#define KEYRC 3
#define KEYLC 2
#define KEYLS 1
#define KEYOTA 2

#define TONEPIN 6

#define ROM_PASSWD 730

#define OLED_RESET 7

#define VERSION "1.33"

Adafruit_SSD1306 display(128, 64, &Wire, OLED_RESET);
//Adafruit_MLX90614 mlx = Adafruit_MLX90614();
/*
GButton keyrs(KEYRS);
GButton keyls(KEYLS);
GButton keyrc(KEYRC);
GButton keylc(KEYLC);
*/

const unsigned char mycow1 [] PROGMEM = {
  // 'mycow1, 128x64px
  0xff, 0xff, 0xff, 0xff, 0xff, 0xff, 0xff, 0xff, 0xff, 0xff, 0xff, 0xff, 0xff, 0xff, 0xff, 0xff,
  0xff, 0xff, 0xff, 0xff, 0xff, 0xff, 0xff, 0xff, 0xff, 0xff, 0xff, 0xff, 0xff, 0xff, 0xff, 0xff,
  0xff, 0xff, 0xff, 0xff, 0xff, 0xff, 0xff, 0xff, 0xff, 0xff, 0xff, 0xff, 0xff, 0xff, 0xff, 0xff,
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  0xff, 0xff, 0xff, 0xff, 0xff, 0xff, 0xff, 0xff, 0xff, 0xff, 0xff, 0xff, 0xff, 0xff, 0xff, 0xff
};

const unsigned char mycow2 [] PROGMEM = {
  // 'mycow2, 128x64px
  0xff, 0xff, 0xff, 0xff, 0xff, 0xff, 0xff, 0xff, 0xff, 0xff, 0xff, 0xff, 0xff, 0xff, 0xff, 0xff,
  0xff, 0xff, 0xff, 0xff, 0xff, 0xff, 0xff, 0xff, 0xff, 0xff, 0xff, 0xff, 0xff, 0xff, 0xff, 0xff,
  0xff, 0xff, 0xff, 0xff, 0xff, 0xff, 0xff, 0xff, 0xff, 0xff, 0xff, 0xff, 0xff, 0xff, 0xff, 0xff,
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  0xff, 0xff, 0xff, 0xff, 0xff, 0xff, 0xff, 0xff, 0xff, 0xff, 0xff, 0xff, 0xff, 0xff, 0xff, 0xff
};

const unsigned char mycow3 [] PROGMEM = {
  // 'mycow3, 128x64px
  0xff, 0xff, 0xff, 0xff, 0xff, 0xff, 0xff, 0xff, 0xff, 0xff, 0xff, 0xff, 0xff, 0xff, 0xff, 0xff,
  0xff, 0xff, 0xff, 0xff, 0xff, 0xff, 0xff, 0xff, 0xff, 0xff, 0xff, 0xff, 0xff, 0xff, 0xff, 0xff,
  0xff, 0xff, 0xff, 0xff, 0xff, 0xff, 0xff, 0xff, 0xff, 0xff, 0xff, 0xff, 0xff, 0xff, 0xff, 0xff,
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  0xff, 0xff, 0xff, 0xff, 0xff, 0xff, 0xff, 0xff, 0xff, 0xff, 0xff, 0xff, 0xff, 0xff, 0xff, 0xff
};


const unsigned char mycow4 [] PROGMEM = {
  // 'mycow4, 128x64px
  0xff, 0xff, 0xff, 0xff, 0xff, 0xff, 0xff, 0xff, 0xff, 0xff, 0xff, 0xff, 0xff, 0xff, 0xff, 0xff,
  0xff, 0xff, 0xff, 0xff, 0xff, 0xff, 0xff, 0xff, 0xff, 0xff, 0xff, 0xff, 0xff, 0xff, 0xff, 0xff,
  0xff, 0xff, 0xff, 0xff, 0xff, 0xff, 0xff, 0xff, 0xff, 0xff, 0xff, 0xff, 0xff, 0xff, 0xff, 0xff,
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  0xff, 0xff, 0xff, 0xff, 0xff, 0xff, 0xff, 0xff, 0xff, 0xff, 0xff, 0xff, 0xff, 0xff, 0xff, 0xff
};

const unsigned char mycow5 [] PROGMEM = {
  // 'mycow5, 128x64px
  0xff, 0xff, 0xff, 0xff, 0xff, 0xff, 0xff, 0xff, 0xff, 0xff, 0xff, 0xff, 0xff, 0xff, 0xff, 0xff,
  0xff, 0xff, 0xff, 0xff, 0xff, 0xff, 0xff, 0xff, 0xff, 0xff, 0xff, 0xff, 0xff, 0xff, 0xff, 0xff,
  0xff, 0xff, 0xff, 0xff, 0xff, 0xff, 0xff, 0xff, 0xff, 0xff, 0xff, 0xff, 0xff, 0xff, 0xff, 0xff,
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  0xff, 0xff, 0xff, 0xff, 0xff, 0xff, 0xff, 0xff, 0xff, 0xff, 0xff, 0xff, 0xff, 0xff, 0xff, 0xff
};

const unsigned char mycow6 [] PROGMEM = {
  // 'mycow6, 128x64px
  0xff, 0xff, 0xff, 0xff, 0xff, 0xff, 0xff, 0xff, 0xff, 0xff, 0xff, 0xff, 0xff, 0xff, 0xff, 0xff,
  0xff, 0xff, 0xff, 0xff, 0xff, 0xff, 0xff, 0xff, 0xff, 0xff, 0xff, 0xff, 0xff, 0xff, 0xff, 0xff,
  0xff, 0xff, 0xff, 0xff, 0xff, 0xff, 0xff, 0xff, 0xff, 0xff, 0xff, 0xff, 0xff, 0xff, 0xff, 0xff,
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  0xff, 0xff, 0xff, 0xff, 0xff, 0xff, 0xff, 0xff, 0xff, 0xff, 0xff, 0xff, 0xff, 0xff, 0xff, 0xff
};

const unsigned char mycow7 [] PROGMEM = {
  // 'mycow7, 128x64px
  0xff, 0xff, 0xff, 0xff, 0xff, 0xff, 0xff, 0xff, 0xff, 0xff, 0xff, 0xff, 0xff, 0xff, 0xff, 0xff,
  0xff, 0xff, 0xff, 0xff, 0xff, 0xff, 0xff, 0xff, 0xff, 0xff, 0xff, 0xff, 0xff, 0xff, 0xff, 0xff,
  0xff, 0xff, 0xff, 0xff, 0xff, 0xff, 0xff, 0xff, 0xff, 0xff, 0xff, 0xff, 0xff, 0xff, 0xff, 0xff,
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  0xff, 0xff, 0xff, 0xff, 0xff, 0xff, 0xff, 0xff, 0xff, 0xff, 0xff, 0xff, 0xff, 0xff, 0xff, 0xff
};

const unsigned char mycow8 [] PROGMEM = {
  // 'mycow8, 128x64px
  0xff, 0xff, 0xff, 0xff, 0xff, 0xff, 0xff, 0xff, 0xff, 0xff, 0xff, 0xff, 0xff, 0xff, 0xff, 0xff,
  0xff, 0xff, 0xff, 0xff, 0xff, 0xff, 0xff, 0xff, 0xff, 0xff, 0xff, 0xff, 0xff, 0xff, 0xff, 0xff,
  0xff, 0xff, 0xff, 0xff, 0xff, 0xff, 0xff, 0xff, 0xff, 0xff, 0xff, 0xff, 0xff, 0xff, 0xff, 0xff,
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  0xff, 0xff, 0xff, 0xff, 0xff, 0xff, 0xff, 0xff, 0xff, 0xff, 0xff, 0xff, 0xff, 0xff, 0xff, 0xff
};


const unsigned char putina_portret [] PROGMEM = {
  // 'putin, 128x64px
  0xff, 0xff, 0xff, 0xff, 0xff, 0xff, 0xff, 0xff, 0xff, 0xff, 0xff, 0xff, 0xff, 0xff, 0xff, 0xff,
  0xff, 0xff, 0xff, 0xff, 0xff, 0xff, 0xff, 0xff, 0xff, 0xff, 0xff, 0xff, 0xff, 0xff, 0xff, 0xff,
  0xff, 0xff, 0xff, 0xff, 0xff, 0xff, 0xff, 0xff, 0xff, 0xff, 0xff, 0xff, 0xff, 0xff, 0xff, 0xff,
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  0x00, 0x00, 0x00, 0x00, 0x00, 0x01, 0xfe, 0x00, 0x1b, 0xff, 0xe0, 0x00, 0x00, 0x00, 0x00, 0x1f
};

const unsigned char putina_portret_vtoroy [] PROGMEM = {
  // 'rian_6364945, 128x64px
  0xff, 0xff, 0xff, 0xff, 0xff, 0xff, 0xff, 0xff, 0xff, 0xff, 0xff, 0xff, 0xff, 0xff, 0xff, 0xff,
  0xf7, 0xbf, 0xff, 0xff, 0xff, 0xff, 0xfe, 0xad, 0x55, 0xff, 0xff, 0xfb, 0xef, 0x76, 0xdb, 0x6b,
  0xbd, 0xeb, 0x6d, 0xb6, 0xdb, 0x6d, 0xab, 0xff, 0xb6, 0xdb, 0x6d, 0xbe, 0xfb, 0xdf, 0xff, 0xfe,
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  0xb6, 0xae, 0xad, 0xda, 0xaa, 0xaa, 0xd6, 0xd7, 0x6d, 0x14, 0x27, 0xb5, 0x4a, 0xeb, 0xaf, 0xbd
};

const unsigned char rickrolled [] PROGMEM = {
  // 'rickroll, 128x64px
  0xff, 0xff, 0xff, 0xff, 0xff, 0xff, 0xff, 0xff, 0xff, 0xff, 0xff, 0xff, 0xff, 0xff, 0xff, 0xff,
  0xff, 0xff, 0xff, 0xff, 0xff, 0xff, 0xff, 0xff, 0xff, 0xff, 0xff, 0xff, 0xff, 0xff, 0xff, 0xff,
  0xff, 0xff, 0xff, 0xff, 0xff, 0xff, 0xff, 0xff, 0xff, 0xff, 0xff, 0xff, 0xff, 0xff, 0xff, 0xff,
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  0xff, 0xff, 0xff, 0xff, 0xff, 0x00, 0x00, 0x00, 0x00, 0x00, 0x00, 0x39, 0xff, 0xff, 0xff, 0xff
};

const unsigned char bread [] PROGMEM = {
  // 'bread, 25x25px
  0x00, 0x08, 0x00, 0x00, 0x00, 0x1c, 0x00, 0x00, 0x60, 0x0c, 0x00, 0x00, 0xf0, 0x00, 0x00, 0x00,
  0x62, 0x00, 0xf0, 0x00, 0x07, 0x07, 0xfe, 0x00, 0x02, 0x1f, 0xcf, 0x00, 0x00, 0x3e, 0x07, 0x80,
  0x03, 0xfe, 0x07, 0x80, 0x07, 0xf7, 0x83, 0x80, 0x0f, 0xf3, 0xe1, 0x80, 0x0f, 0x38, 0x71, 0x80,
  0x1f, 0x1c, 0x38, 0x80, 0x1f, 0x8f, 0x18, 0x80, 0x3f, 0xe3, 0x83, 0x80, 0x39, 0xf3, 0xc7, 0x00,
  0x38, 0xf9, 0xcf, 0x00, 0x3c, 0x38, 0xc6, 0x00, 0x1c, 0x00, 0x1e, 0x00, 0x0f, 0x81, 0xfc, 0x00,
  0x07, 0xff, 0xf8, 0x00, 0x21, 0xfe, 0x00, 0x00, 0x70, 0x00, 0x00, 0x00, 0x20, 0x00, 0x00, 0x00,
  0x00, 0x00, 0x00, 0x00
};

const unsigned char cat [] PROGMEM = {
  // 'cat, 25x25px
  0x00, 0x00, 0x00, 0x00, 0x00, 0x00, 0x00, 0x00, 0x18, 0x00, 0x00, 0x00, 0x1e, 0x00, 0x1c, 0x00,
  0x13, 0x80, 0x36, 0x00, 0x18, 0xf1, 0xe6, 0x00, 0x1b, 0xff, 0xe6, 0x00, 0x0f, 0x80, 0x36, 0x00,
  0x0c, 0x00, 0x1c, 0x00, 0x0c, 0x00, 0x1f, 0x00, 0x0c, 0xa2, 0x9f, 0x80, 0x04, 0xe3, 0x91, 0x80,
  0x04, 0x08, 0x30, 0x80, 0x06, 0x00, 0x30, 0x80, 0x02, 0x38, 0x20, 0x80, 0x03, 0x24, 0x60, 0x80,
  0x03, 0x80, 0xc0, 0x00, 0x01, 0x81, 0x80, 0x00, 0x01, 0xff, 0x00, 0x00, 0x00, 0x7c, 0x00, 0x80,
  0x00, 0x79, 0x00, 0x80, 0x00, 0x39, 0x86, 0x80, 0x00, 0x13, 0x09, 0x80, 0x00, 0x0e, 0x4b, 0x80,
  0x00, 0x0c, 0x83, 0x80
};



const unsigned char blow [] PROGMEM = {
  // 'blow, 8x8px
  0x82, 0x28, 0x0e, 0xa4, 0x1b, 0x56, 0x28, 0x85
};

const unsigned char blow1 [] PROGMEM = {
  // 'blow1, 8x8px
  0x82, 0x38, 0x6d, 0xa4, 0x7a, 0x5e, 0x2c, 0x01
};

const unsigned char gunlet [] PROGMEM = {
  // 'gunlet, 8x8px
  0x7e, 0xeb, 0xb9, 0xc3, 0x7e, 0x3c, 0x18, 0x18
};

const unsigned char gunlet1 [] PROGMEM = {
  // 'gunlet1, 8x8px
  0x76, 0xcb, 0xa9, 0xc3, 0x26, 0x34, 0x9a, 0x1a
};

const unsigned char impostor [] PROGMEM = {
  // 'burjui, 8x8px
  0x24, 0xa5, 0xa5, 0xff, 0xdb, 0x24, 0x18, 0x18
};

const unsigned char fighter [] PROGMEM = {
  // 'fighter, 8x8px
  0x00, 0x18, 0x08, 0x99, 0xff, 0xbd, 0xdb, 0x81
};

const unsigned char piano_logo [] PROGMEM = {
  0x03, 0xff, 0xff, 0xf0, 0x00, 0x0e, 0x00, 0x00, 0x1c, 0x00, 0x18, 0x00, 0x00, 0x06, 0x00, 0x30,
  0x00, 0x00, 0x03, 0x00, 0x60, 0x00, 0x00, 0x01, 0x80, 0x40, 0x00, 0x00, 0x00, 0x80, 0xc0, 0x00,
  0x00, 0x00, 0xc0, 0x80, 0x00, 0x00, 0x00, 0x40, 0xfe, 0x3f, 0x1f, 0x1f, 0xc0, 0xfe, 0x3f, 0x1f,
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  0x0f, 0x7f, 0xbf, 0xbc, 0x00, 0x03, 0xff, 0xff, 0xf0, 0x00
};

const unsigned char std_logo [] PROGMEM = {
	// 'pixil-frame-0 (3), 34x34px
	0x03, 0xff, 0xff, 0xf0, 0x00, 0x0e, 0x00, 0x00, 0x1c, 0x00, 0x18, 0x00, 0x00, 0x06, 0x00, 0x30,
	0x00, 0x0e, 0x03, 0x00, 0x60, 0x0f, 0x0b, 0x01, 0x80, 0x40, 0x1d, 0x1f, 0x80, 0x80, 0xc0, 0x3f,
	0x1f, 0x40, 0xc0, 0x80, 0x7f, 0x39, 0xe0, 0x40, 0x80, 0xfe, 0x19, 0xf0, 0x40, 0x81, 0xfc, 0x3f,
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	0x0e, 0x00, 0x00, 0x1c, 0x00, 0x03, 0xff, 0xff, 0xf0, 0x00
};

const unsigned char korobkaTube_logo [] PROGMEM = {
	// 'KorobkaTube, 34x34px
	0x03, 0xff, 0xff, 0xf0, 0x00, 0x0e, 0x00, 0x00, 0x1c, 0x00, 0x18, 0x00, 0x00, 0x06, 0x00, 0x30,
	0x00, 0x00, 0x03, 0x00, 0x60, 0x00, 0x00, 0x01, 0x80, 0x40, 0x00, 0x00, 0x00, 0x80, 0xc0, 0x00,
	0x00, 0x00, 0xc0, 0x80, 0x00, 0x00, 0x00, 0x40, 0x80, 0x78, 0x00, 0x00, 0x40, 0x80, 0xfe, 0x00,
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	0x0e, 0x00, 0x00, 0x1c, 0x00, 0x03, 0xff, 0xff, 0xf0, 0x00
};

const unsigned char phisics_logo [] PROGMEM = {
  // 'phisics, 34x34px
  0x03, 0xff, 0xff, 0xf0, 0x00, 0x0e, 0x00, 0x00, 0x1c, 0x00, 0x18, 0x00, 0x00, 0x06, 0x00, 0x30,
  0x00, 0x00, 0x03, 0x00, 0x60, 0x00, 0x00, 0x01, 0x80, 0x40, 0x02, 0x00, 0x00, 0x80, 0xc0, 0x02,
  0x00, 0x00, 0xc0, 0x81, 0xd3, 0xe1, 0xe0, 0x40, 0x83, 0xf3, 0xf3, 0xf0, 0x40, 0x82, 0x12, 0x12,
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  0x0e, 0x00, 0x00, 0x1c, 0x00, 0x03, 0xff, 0xff, 0xf0, 0x00
};

const unsigned char cat_or_bread_logo [] PROGMEM = {
  // 'cat_or_bread, 34x34px
  0x03, 0xff, 0xff, 0xf0, 0x00, 0x0e, 0x00, 0x00, 0x1c, 0x00, 0x18, 0x3e, 0x01, 0x06, 0x00, 0x30,
  0x60, 0x01, 0x03, 0x00, 0x60, 0x40, 0x73, 0x81, 0x80, 0x40, 0x40, 0x51, 0x00, 0x80, 0xc0, 0x40,
  0x99, 0x00, 0xc0, 0x80, 0x60, 0xd9, 0x00, 0x40, 0x80, 0x1e, 0x79, 0x00, 0x40, 0x80, 0x00, 0x00,
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  0x0e, 0x00, 0x00, 0x1c, 0x00, 0x03, 0xff, 0xff, 0xf0, 0x00
};

const unsigned char tanchiki_logo [] PROGMEM = {
  // 'tanchiki, 34x34px
  0x03, 0xff, 0xff, 0xf0, 0x00, 0x0e, 0x00, 0x00, 0x1c, 0x00, 0x18, 0x7f, 0xfc, 0x06, 0x00, 0x30,
  0x58, 0x34, 0x13, 0x00, 0x60, 0x77, 0xfc, 0x01, 0x80, 0x44, 0x55, 0x74, 0x00, 0x80, 0xc0, 0x77,
  0xfc, 0x00, 0xc0, 0xe0, 0x53, 0xb4, 0x20, 0x40, 0x80, 0x73, 0xbc, 0x00, 0x40, 0x80, 0x51, 0x34,
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  0x01, 0xff, 0xff, 0xe0, 0x00, 0x00, 0x00, 0x00, 0x00, 0x00
};


const unsigned char space_heroes_logo [] PROGMEM = {
  // 'sapce_heroes, 34x34px
  0x03, 0xff, 0xff, 0xf0, 0x00, 0x0e, 0x00, 0x00, 0x1c, 0x00, 0x18, 0x90, 0x00, 0x06, 0x00, 0x32,
  0x94, 0x00, 0x03, 0x00, 0x62, 0x94, 0x00, 0x01, 0x80, 0x43, 0xfc, 0x00, 0x90, 0x80, 0xc3, 0x6c,
  0x02, 0x94, 0xc0, 0x80, 0x90, 0x02, 0x94, 0x40, 0x80, 0x64, 0x13, 0xfc, 0x40, 0x80, 0x61, 0xc3,
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  0x0e, 0x00, 0x00, 0x1c, 0x00, 0x03, 0xff, 0xff, 0xf0, 0x00
};

const unsigned char thermometer_logo [] PROGMEM = {
  // 'thermometer, 34x34px
  0x03, 0xff, 0xff, 0xf0, 0x00, 0x0e, 0x00, 0x0b, 0xdc, 0x00, 0x18, 0x00, 0x07, 0xfe, 0x00, 0x30,
  0x12, 0x00, 0xff, 0x00, 0x60, 0x38, 0x00, 0x01, 0x80, 0x40, 0x10, 0x00, 0x00, 0x80, 0xc0, 0x10,
  0x00, 0x00, 0xc0, 0x80, 0x18, 0x00, 0x00, 0x40, 0x80, 0x00, 0x00, 0x00, 0x40, 0x86, 0x00, 0x07,
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  0x0f, 0xff, 0xff, 0x9c, 0x00, 0x03, 0xff, 0xff, 0xf0, 0x00
};

const unsigned char lambda_logo [] PROGMEM = {
  // 'lambda, 34x34px
  0x03, 0xff, 0xff, 0xf0, 0x00, 0x0e, 0x00, 0x00, 0x1c, 0x00, 0x18, 0x00, 0x00, 0x06, 0x00, 0x30,
  0x00, 0x00, 0x03, 0x00, 0x60, 0x7f, 0x00, 0x01, 0x80, 0x40, 0x7f, 0x80, 0x00, 0x80, 0xc0, 0x7f,
  0xc0, 0x00, 0xc0, 0x80, 0x0f, 0xe0, 0x00, 0x40, 0x80, 0x07, 0xe0, 0x00, 0x40, 0x80, 0x03, 0xf0,
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  0x0e, 0x00, 0x00, 0x1c, 0x00, 0x03, 0xff, 0xff, 0xf0, 0x00
};

const unsigned char beer_logo [] PROGMEM = {
  0x03, 0xff, 0xff, 0xf0, 0x00, 0x0e, 0x00, 0x00, 0x1c, 0x00, 0x18, 0x00, 0x00, 0x06, 0x00, 0x30,
  0x00, 0x00, 0x03, 0x00, 0x60, 0x00, 0x00, 0x01, 0x80, 0x40, 0x00, 0x00, 0x00, 0x80, 0xde, 0x79,
  0xe7, 0x90, 0xc0, 0x9a, 0x69, 0xa6, 0xd0, 0x40, 0x9a, 0x61, 0x86, 0x87, 0x40, 0x9e, 0x71, 0xc7,
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  0x0e, 0x00, 0x00, 0x1c, 0x00, 0x03, 0xff, 0xff, 0xf0, 0x00
};

const unsigned char terminal_logo [] PROGMEM = {
  // 'cutecom, 34x34px
  0x03, 0xff, 0xff, 0xf0, 0x00, 0x0e, 0x00, 0x00, 0x1c, 0x00, 0x18, 0x00, 0x00, 0x06, 0x00, 0x30,
  0x00, 0x00, 0x03, 0x00, 0x60, 0x00, 0x00, 0x01, 0x80, 0x40, 0x00, 0x00, 0x00, 0x80, 0xc0, 0x00,
  0x00, 0x00, 0xc0, 0x80, 0x00, 0x00, 0x00, 0x40, 0x80, 0x00, 0x00, 0x00, 0x40, 0x80, 0x00, 0x00,
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  0x0e, 0x00, 0x00, 0x1c, 0x00, 0x03, 0xff, 0xff, 0xf0, 0x00
};

const unsigned char WiFi_logo [] PROGMEM = {
  // 'wifi-2, 58x40px
  0xff, 0xff, 0xff, 0xff, 0xff, 0xff, 0xff, 0xc0, 0xff, 0xff, 0xfe, 0x00, 0x1f, 0xff, 0xff, 0xc0,
  0xff, 0xff, 0xf0, 0x00, 0x03, 0xff, 0xff, 0xc0, 0xff, 0xff, 0xe0, 0x00, 0x00, 0xff, 0xff, 0xc0,
  0xff, 0xff, 0x80, 0x00, 0x00, 0x7f, 0xff, 0xc0, 0xff, 0xff, 0x00, 0x00, 0x00, 0x3f, 0xff, 0xc0,
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  0xff, 0xff, 0xfc, 0x00, 0x0f, 0xff, 0xff, 0xc0, 0xff, 0xff, 0xff, 0xc0, 0xff, 0xff, 0xff, 0xc0
};

const unsigned char watch_logo [] PROGMEM = {
	// 'watch, 34x34px
	0x03, 0xff, 0xff, 0xf0, 0x00, 0x0e, 0x00, 0x00, 0x1c, 0x00, 0x18, 0x01, 0x60, 0x86, 0x00, 0x30,
	0x01, 0x20, 0x83, 0x00, 0x61, 0x41, 0x40, 0x81, 0x80, 0x41, 0x41, 0x60, 0x80, 0x80, 0xc1, 0x40,
	0x00, 0x00, 0xc0, 0x80, 0x00, 0x00, 0x06, 0x40, 0x80, 0x00, 0x00, 0x02, 0x40, 0x8b, 0x00, 0x00,
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	0x0e, 0x00, 0x00, 0x1c, 0x00, 0x03, 0xff, 0xff, 0xf0, 0x00
};


const unsigned char *cow[8] PROGMEM = {mycow1, mycow2, mycow3, mycow4, mycow5, mycow6, mycow7, mycow8};

const char *settings[] = {"music", "cat or bread delay", "About device", "Tools", "Обновления"};
const char *keys[] = {"KEY1", "KEY2", "KEY3", "KEY4"};
const char *note_names[] = {"ДО", "РЕ", "МИ", "ФА", "СОЛЬ", "ЛЯ", "СИ", "ДО2"};
const int notes[] = {261, 293, 329, 349, 392, 440, 493, 526};

const char *comedy_text[]  =
{ "Божественная комедия:\n1 Земную жизнь пройдя до половины,\nЯ очутился в сумрачном лесу,\nУтратив правый путь во тьме долины.",
  "4 Каков он был, о, как произнесу,\nТот дикий лес, дремучий и грозящий,\nЧей давний ужас в памяти несу!",
  "7 Так горек он, что смерть едва ль не слаще.\nНо, благо в нем обретши навсегда,\nСкажу про все, что видел в этой чаще.",
  "10 Не помню сам, как я вошел туда,\nНастолько сон меня опутал ложью,\nКогда я сбился с верного следа.",
  "13 Но к холмному приблизившись подножью,\nКоторым замыкался этот дол,\nМне сжавший сердце ужасом и дрожью,",
  "16 Я увидал, едва глаза возвел,\nЧто свет планеты, всюду путеводной,\nУже на плечи горные сошел.",
  "19 Тогда вздохнула более свободной\nИ долгий страх превозмогла душа,\nИзмученная ночью безысходной.",
  "22 И словно тот, кто, тяжело дыша,\nНа берег выйдя из пучины пенной,\nГлядит назад, где волны бьют, страша,",
  "25 Так и мой дух, бегущий и смятенный,\nВспять обернулся, озирая путь,\nВсех уводящий к смерти предреченной."
};

WiFiClientSecure wificlient;

void(* resetFunc) (void) = 0;

int firststep = 0;
int steps = 0;
byte rbtnr = 1;
byte rbtnl = 1;
byte fwdbtn = 1;
byte shtbtn = 1;
int gxb = 15;
int gyb = 7;
int grb = 3;
int gxw = 0;
int gyw = 0;
int grw = 1;
int lastx;
int lasty;
byte rngb = 5;
byte rngw = 5;

byte carta[16][8];

int gameNum = 0;

int laserTime = 0;
int laserX;
int blowNum = 1;
int fighterX = 0;
int impostorX = 0;
int impostorY = 0;
int shootY = 52;
int shootX;
byte blown = 0;
long int laserTimer = 0;
long int cooldown = 0;
long int killDelay = 0;
long int atackTimer = 0;
int impostorExit;
int score = 0;
int rockets = 0;
int rocketScore = 0;
int doorFrame;
int torpedaX;
int torpedaY;
int gone = 0;
byte gamemode = 0;
byte gun1State = 0;
byte gun2State = 0;
byte gun3State = 0;


int hard = 1000;
int table[4];
int catsCountK;
int hardFall;
long int kIncreaseTimer = 0;
long int hardFallTimer = 0;
int count = 0;

long int timer = 0;
int dead = 2;

void wait() {
  delay(1000000 * EEPROM.read(65) + 5000);
  ESP.restart();
}
/*
  void setup1() {
  pinMode(25, OUTPUT);
  }

  void loop1() {
  delay(200);
  midi();
  }
*/

String utf8rus(String source)
{
  int i, k;
  String target;
  unsigned char n;
  char m[2] = { '0', '\0' };
  k = source.length(); i = 0;
  while (i < k) {
    n = source[i]; i++;
    if (n >= 0xC0) {
      switch (n) {
        case 0xD0: {
            n = source[i]; i++;
            if (n == 0x81) {
              n = 0xA8;
              break;
            }
            if (n >= 0x90 && n <= 0xBF) n = n + 0x30;
            break;
          }
        case 0xD1: {
            n = source[i]; i++;
            if (n == 0x91) {
              n = 0xB8;
              break;
            }
            if (n >= 0x80 && n <= 0x8F) n = n + 0x70;
            break;
          }
      }
    }
    m[0] = n; target = target + String(m);
  }
  return target;
}

// Include all your app files down here...


bool thermo_type = 1;

WebServer gameServer(80);

class KServo {
public:
  KServo(int ledcChannel) {
    _ledcChannel = ledcChannel;
    ledcSetup(_ledcChannel, 50, 12);
  }
  void attach(int gpio) {
    _gpio = gpio;
    ledcAttachPin(_gpio, 0);
  }
  void write(int angle) {
    _duty = map(angle, 0, 180, 80, 510);
    ledcWrite(_ledcChannel, _duty);
  }
private:
  int _ledcChannel;
  int _gpio;
  int _duty;
};





class Pong {
  public:
    String gameName = "KorobochkaPong";

    String gamePass = "pongpong";

    float leftRacket = 0;
    float rightRacket = 0;
    int racketSize = 20;

    float botSpeed = 0.5;

    int countLeft = 0;
    int countRight = 0;

    int mspt = 100;

    int speed = 1;

    int timer = millis();

    bool ai = false;

    struct {
      float x = 64.0;
      float y = 32.0;
      float speedX = 1.0;
      float speedY = -1.0;
    } ball;

    void drawScene() {
      display.clearDisplay();
      display.drawFastVLine(0, leftRacket, racketSize, 1);
      display.drawFastVLine(127, rightRacket, racketSize, 1);
      display.drawPixel(ball.x, ball.y, 1);
      display.setCursor(56, 28);
      display.print(countLeft);
      display.setCursor(67, 28);
      display.print(countRight);
      display.setCursor(0, 5);
      display.print("ping "+String(requestMeter));
      display.drawFastVLine(64, 0, 64, 1);
      for(byte i = 0; i < 64; i += 8) {
        display.drawFastVLine(64, i, 4, 0);
      }
      display.display();
    }

    void leftButtons() {
      if(!digitalRead(KEYLS)) leftRacket-=speed;
      if(!digitalRead(KEYLC)) leftRacket+=speed;
    }

    void rightButtons() {
      if(!digitalRead(KEYRS)) rightRacket-=speed;
      if(!digitalRead(KEYRC)) rightRacket+=speed;
    }

    void bounds() {
      if(rightRacket > 64 - racketSize) rightRacket--;
      if(leftRacket > 64 - racketSize) leftRacket--;
      if(rightRacket < 0) rightRacket++;
      if(leftRacket < 0) leftRacket++;
      if(ball.y < 1 or ball.y > 62) {
        ball.speedY = -1 * ball.speedY;

      }
    }

    void rightBounds() {
      if(rightRacket > 64 - racketSize) rightRacket-=speed;
      if(rightRacket < 0) rightRacket+=speed;
    }

    void win(bool player) {
      display.setTextSize(2);
      display.setCursor(10 + player * 75, 28);
      display.print("WIN");
      display.display();
      delay(3000);

    }

    void ballToCenter() {
      ball.x = 64.0;
      ball.y = 32.0;
      ball.speedX = bool(random(0, 2)) ? 1 : -1;
      ball.speedY = bool(random(0, 2)) ? 1 : -1;
    }

    void moveBall() {
      ball.x += ball.speedX;
      ball.y += ball.speedY;
    }

    void checkHit() {
      if(ball.x > 125) {
        if(rightRacket < ball.y and rightRacket+racketSize > ball.y) {
          ball.speedX = -1 * ball.speedX * 0.1 * random(8, 15);
          ball.speedY *= 0.1 * random(-15, 15);
          ball.x -= 3;
        }
        else {
          countLeft++;
          //if(countLeft > 9) win(0);
          ballToCenter();
        }

      }
      else if(ball.x < 2) {
        if(leftRacket < ball.y and leftRacket+racketSize > ball.y) {
          ball.speedX = -1 * ball.speedX * 0.1 * random(8, 15);
          ball.speedY = ball.speedY * 0.1 * random(-15, 15) + 0.1 * random(-5, 5);
          ball.x += 3;
        }
        else {
          countRight++;
          //if(countRight > 9) win(1);
          ballToCenter();
        }
      }
    }

    void think() {
      if(ball.y > leftRacket + racketSize / 2) leftRacket += 0.5;
      else leftRacket -= 0.5;
    }

    void play(){
      display.setTextSize(1);
      display.setFont(&Picopixel);
      drawScene();
      while(1) {
        if(millis() - timer > mspt) {
          rightButtons();
          if(ai) think();
          if(!ai) leftButtons();
          bounds();
          moveBall();
          checkHit();
          drawScene();
        }
      }
    }



    void playServer() {
      String apName = gameName + " " + String(WiFi.macAddress()).substring(0, 2);
      Serial.println("Started wifi ap");
      WiFi.enableAP(true);
      delay(100);
      WiFi.softAP(apName.c_str(), gamePass.c_str());
      delay(500);
      Serial.println(String(WiFi.softAPIP()));
      display.setTextSize(1);

      drawScene();

      display.setCursor(0, 0);
      display.print(WiFi.softAPIP());
      display.display();

      gameServer.on("/rules", sendRules);
      gameServer.on("/game", playGame);

      gameServer.begin();

      while(WiFi.softAPgetStationNum() == 0){
        message("ready...", 100);
      }
      display.setFont(&Picopixel);
      display.setTextSize(1);
      while(1) {
        gameServer.handleClient();
        if(millis() - timer > mspt) {
          rightButtons();
          bounds();
          moveBall();
          checkHit();
          drawScene();
        }
      }
    }
    int requestMeter = 0;
    void getData() {
      requestMeter = millis();
      HTTPClient http;
      http.begin("http://192.168.4.1/game?pos="+String(rightRacket));
      http.GET();
      String raw = http.getString();
      requestMeter = millis()-requestMeter;
      int game[5];
      for(int i = 0; i < 5; i++) {
        int ind = raw.indexOf(";");
        game[i] = raw.substring(0, ind).toInt();
        raw.remove(0, ind+1);
      }
      leftRacket = game[0];
      countRight = game[1];
      countLeft = game[2];
      ball.x = 128-game[3];
      ball.y = game[4];

    }

    void playClient() {
      speed = 2;
      message("searcing room", 10);
      int n = WiFi.scanNetworks();
      int room = 0;
      for (int i = 0; i < n; ++i) {
        if(String(WiFi.SSID(i)).substring(0, gameName.length()) == gameName) {
          room = i;
          break;
        }
      }
      String roomName = WiFi.SSID(room);
      WiFi.mode(WIFI_STA);
      WiFi.begin(roomName.c_str(), gamePass.c_str());
      message("connecting", 500);
      while (WiFi.status() != WL_CONNECTED) {
        Serial.print('.');
        delay(200);
      }
      display.clearDisplay();
      display.setCursor(0, 0);
      display.setTextSize(1);
      display.println(WiFi.localIP());
      HTTPClient http;
      http.begin("http://192.168.4.1/rules");
      http.GET();
      String rawRules = http.getString();
      display.println(rawRules);
      int ri = rawRules.indexOf(";");
      mspt = rawRules.substring(0, ri).toInt();
      racketSize = rawRules.substring(ri + 1).toInt();
      display.println(mspt);
      display.println(racketSize);
      display.display();
      display.setTextSize(1);
      display.setFont(&Picopixel);
      while(1){
        if(millis() - timer > mspt) {
          rightButtons();
          rightBounds();
          getData();
          drawScene();
        }
      };
    }
} pong;

void sendRules() {
  String json = String(pong.mspt)+";"+String(pong.racketSize);
  gameServer.send(200, "text/plain", json);
}

void playGame() {
  pong.leftRacket = String(gameServer.arg("pos")).toInt();
  String json = String(int(pong.rightRacket))+";"+String(int(pong.countLeft))+";"+String(int(pong.countRight))+";"+String(int(pong.ball.x))+";"+String(int(pong.ball.y));
  gameServer.send(200, "text/plain", json);
}

struct {
  void play() {
    KServo myservo(0);
    myservo.attach(6);
    int pos = 90;
    //int radius = 40;
    display.setTextSize(2);
    while(true) {
      if(!digitalRead(KEYLS)) pos --;
      if(!digitalRead(KEYRS)) pos ++;
      if(pos < 0) pos = 0;
      if(pos > 180) pos = 180;
      myservo.write(pos);
      display.clearDisplay();
      display.setCursor(0, 0);
      display.print(String(pos));
      display.display();
      delay(10);
    }
  }
} servoTester;
/*
struct {
  int pos = 90;
  bool thrust = 0;
  void play() {
    pinMode(7, OUTPUT);
    KServo myservo(0);
    myservo.attach(6);
    String apName = String("KCar") + String(" ") + String(WiFi.macAddress()).substring(0, 2);
    Serial.println("Started wifi ap");
    WiFi.enableAP(true);
    delay(100);
    WiFi.softAP(apName.c_str(), "1234567890");
    delay(100);
    //message(apName.c_str(), 100);
    gameServer.on("/", sendIndex);
    gameServer.on("/data", carData);
    gameServer.begin();
    while(true){
      gameServer.handleClient();
      delay(1);
      digitalWrite(7, thrust);
    }
  }

} KCar;

void sendIndex() {

const char page[] PROGMEM = R"=====(
<!DOCTYPE html>
<html>
<head>
 <title>KCar</title>
</head>
<body>
 <h1>KoobochkaCar</h1>
 <button onclick="a = 45">LEFT</button>
 <button onclick="a = 90">CENTER</button>
 <button onclick="a = 135">RIGHT</button>
 <button onclick="t = 1">ON</button>
 <button onclick="a = 0">OFF</button>
 <script>
 let a = 90
 let t = 0
 setInterval(function() {
   fetch("/data?pos="+a+"&thrust="+t)
 }, 100)
 </script>
</body>
</html>
)=====";

  gameServer.send(200, "text/html", page);
}
void carData() {
  KCar.thrust = gameServer.arg("thrust").toInt();
  KCar.pos = bool(gameServer.arg("pos").toInt());
  gameServer.send(200, "text/plain", "ok");
}
*/

struct {
  struct {
    int min = 1;
    int max = 25;
  } val;

  void drawResult(int number) {
    display.setFont(&seg40pt7b);
    String s = String(number);
    if(s.length() == 1) s = "0" + s;
    display.clearDisplay();
    display.setCursor(20, 60);
    display.setTextSize(1);
    display.print(s);
    display.display();
  }

  void play() {
    int tmr = millis();
    int rand = 0;
    gpio_wakeup_enable(GPIO_NUM_4, GPIO_INTR_LOW_LEVEL);
    gpio_wakeup_enable(GPIO_NUM_3, GPIO_INTR_LOW_LEVEL);
    gpio_wakeup_enable(GPIO_NUM_2, GPIO_INTR_LOW_LEVEL);
    gpio_wakeup_enable(GPIO_NUM_1, GPIO_INTR_LOW_LEVEL);
    esp_sleep_enable_gpio_wakeup();
    drawResult(rand);
    while(1) {

      if(millis() - tmr >= 10000) {
        Wire.begin();
        Wire.beginTransmission(60);
        byte cmode = 0x00;
        byte command = 0xAE;
        Wire.write(cmode);
        Wire.write(command);
        Wire.endTransmission();
        delay(50);
        esp_light_sleep_start();

        delay(300);

        command = 0xAF;
        Wire.begin();
        Wire.beginTransmission(60);
        Wire.write(cmode);
        Wire.write(command);
        Wire.endTransmission();
        tmr = millis();
        drawResult(rand);
      }

      if(!digitalRead(KEYRS) or !digitalRead(KEYRC)) {
        delay(300);
        while(digitalRead(KEYLS) and digitalRead(KEYLC) and digitalRead(KEYRC) and digitalRead(KEYRS)) {
          rand = random(val.min, val.max);
          drawResult(rand);
          delay(10);
        }
        delay(300);
        tmr = millis();

      }
      if(!digitalRead(KEYLS) or !digitalRead(KEYLC)) {
        delay(300);
        val.max = korobkaInput(2, 50, 1, val.max)+1;
        delay(300);
        tmr = millis();
        drawResult(rand);
      }

    }
  }
} Sitin;

struct {
  void play(){
    BleKeyboard bleKeyboard("Korobochka BLE",  "esys", 99);
    bleKeyboard.begin();

    while(!bleKeyboard.isConnected()) message("not connected", 100);

    Wire.begin();
    Wire.beginTransmission(60);
    byte cmode = 0x00;
    byte command = 0xAE;
    Wire.write(cmode);
    Wire.write(command);
    Wire.endTransmission();

    while(true){
      if(bleKeyboard.isConnected()) {
        if(!digitalRead(KEYLS)){
          bleKeyboard.write(KEY_MEDIA_VOLUME_DOWN);
          delay(200);
        }
        if(!digitalRead(KEYRC)){
          bleKeyboard.write(KEY_MEDIA_VOLUME_UP);
          delay(200);
        }
        if(!digitalRead(KEYLC)){
          bleKeyboard.press(KEY_LEFT_CTRL);
          bleKeyboard.press(KEY_F4);
          delay(100);
          bleKeyboard.releaseAll();
          delay(100);
        }
        if(!digitalRead(KEYRS)){
          bleKeyboard.write(KEY_MEDIA_PLAY_PAUSE);
          delay(200);
        }
      }
    }
  }

} board;

struct {
  String serverURL = "https://efim-sys.github.io/korobkaTube/";
  void play() {
    unsigned char frame[1024];
    message("arr ok", 300);
    WiFi.begin(ssid.c_str(), password.c_str());
    message("connecting to WiFi", 100);
    display.clearDisplay();
    while(WiFi.status() != WL_CONNECTED) {
      delay(200);
    }
    message("get videos", 1);
    HTTPClient http;
    http.begin(serverURL.c_str());
    http.GET();
    String payload = http.getString();
    int countVideos = payload.substring(0, payload.indexOf('\n')).toInt();
    payload.remove(0, payload.indexOf('\n')+1);
    struct {
      String name;
      String url;
      int samples;
    } props[countVideos];
    const char *vidMenu[countVideos];

    for(int i = 0; i < countVideos; i++){
      props[i].name = payload.substring(0, payload.indexOf('\n'));
      vidMenu[i] = props[i].name.c_str();
      payload.remove(0, payload.indexOf('\n')+1);
      props[i].url = payload.substring(0, payload.indexOf('\n'));
      payload.remove(0, payload.indexOf('\n')+1);
      props[i].samples = payload.substring(0, payload.indexOf('\n')).toInt();
      payload.remove(0, payload.indexOf('\n')+1);
    }
    while(true){
    byte n = korobkaMenu(countVideos, vidMenu);
    int samples = props[n].samples;
    const char* vidUrl = props[n].url.c_str();
    for(int f = 0; f < samples; f++){

      String path = serverURL + String(vidUrl) + "/" + String(f) + ".ktube";
      http.begin(path.c_str());
      http.GET();
      payload = http.getString();
      for(int j = 0; j < 10; j++) {
        for(int i = 0; i < 1024; i++) {
          frame[i] = payload[i+j*1024];
        }
        display.clearDisplay();
        display.drawBitmap(0, 0, frame, 128, 64, 1);
        display.display();
        if(!digitalRead(KEYRS)) {
          display.setCursor(0, 0);
          display.print("Pause");
          display.display();
          delay(200);
          while(digitalRead(KEYRS)) delay(50);
          delay(200);
        }
      }
    }

  }
}
} korobkaTube;

struct KeyProp {
  String normalSymbol;
  String shiftSymbol;
};

struct {
  bool shift = false;
  byte YOffset = 14;
  byte XOffset = 4;
  byte cellWidth = 12;
  byte cellHeight = 10;
  int cursorX = 0;
  byte cursorY = 0;
  String text;


  KeyProp keyboard [5][10] = {
    {(KeyProp) {"1", "!"}, (KeyProp) {"2", "@"},(KeyProp) {"3", "#"},(KeyProp) {"4", "$"},(KeyProp) {"5", "%"},(KeyProp) {"6", "^"},(KeyProp) {"7", "&"},(KeyProp) {"8", "*"},(KeyProp) {"9", "("},(KeyProp) {"0", ")"}},
    {(KeyProp) {"q", "Q"},(KeyProp) {"w", "W"},(KeyProp) {"e", "E"},(KeyProp) {"r", "R"},(KeyProp) {"t", "T"},(KeyProp) {"y", "Y"},(KeyProp) {"u", "U"},(KeyProp) {"i", "I"},(KeyProp) {"o", "O"},(KeyProp) {"p", "P"}},
    {(KeyProp) {"a", "A"},(KeyProp) {"s", "S"},(KeyProp) {"d", "D"},(KeyProp) {"f", "F"},(KeyProp) {"g", "G"},(KeyProp) {"h", "H"},(KeyProp) {"j", "J"},(KeyProp) {"k", "K"},(KeyProp) {"l", "L"},(KeyProp) {"Bk", "Bk"}},
    {(KeyProp) {"z", "Z"},(KeyProp) {"x", "X"},(KeyProp) {"c", "C"},(KeyProp) {"v", "V"},(KeyProp) {"b", "B"},(KeyProp) {"n", "N"},(KeyProp) {"m", "M"},(KeyProp) {",", "<"},(KeyProp) {".", ">"},(KeyProp) {"En", "En"}},
    {(KeyProp) {"Sh", "Sh"},(KeyProp) {"\'", "\""},(KeyProp) {":", ";"},(KeyProp) {"\\", "|"},(KeyProp) {String(char(0x03)), "~"},(KeyProp) {"-", "_"},(KeyProp) {"+", "="},(KeyProp) {" ", " "},(KeyProp) {"/", "?"},(KeyProp) {String(char(0x0b)), String(char(0x0c))}}
  };

  String play(String def = "") {
    shift = false;
    text = def;
    while(true){
      updateScreen();
      delay(150);
      while(digitalRead(KEYRS) and digitalRead(KEYRC) and digitalRead(KEYLS) and digitalRead(KEYLC)) delay(2);
      if(!digitalRead(KEYLC)) {
        cursorX = (cursorX + 1) % 10;
      }
      if(!digitalRead(KEYRC)) {
        cursorY = (cursorY + 1) % 5;
      }
      if(!digitalRead(KEYLS)) {
        cursorX -= 1;
        if(cursorX < 0) cursorX = 9;
      }
      if(!digitalRead(KEYRS)) {
        String symbol = shift?keyboard[cursorY][cursorX].shiftSymbol:keyboard[cursorY][cursorX].normalSymbol;
        if(symbol == "Sh") shift = !shift;
        else if(symbol == "Bk") text.remove(text.length()-1);
        else if(symbol == "En") break;
        else text+=symbol;
      }
    }
    return text;
  }

  void updateScreen() {
    drawBase();
    drawCursor();
    display.setCursor(0, 0);
    display.print(text);
    display.display();
  }

  void drawBase() {
    display.clearDisplay();
    for(int i = 0; i < 5; i++){
      for(int j = 0; j < 10; j++){
        display.setCursor(cellWidth*j+XOffset+1+(cellWidth/2-keyboard[i][j].normalSymbol.length()*3), cellHeight*i+YOffset+1+(cellHeight/2-4));
        display.print(shift?keyboard[i][j].shiftSymbol:keyboard[i][j].normalSymbol);
      }
    }
  }

  void drawCursor() {
    display.drawRect(cursorX*cellWidth+XOffset, cursorY*cellHeight+YOffset, cellWidth, cellHeight, 1);
  }

} korobkaKeyboard;

void gamMenu() {
  int btn0 = !BTN;
  int btn2 = !BTN;
  int btn3 = !BTN;
  int mapnum = 0;
  int enter = 0;
  while (enter == BTN) {
    display.clearDisplay();
    display.setCursor(0, 3);
    display.setTextSize(2);
    display.print(utf8rus("  Выбирай"));
    switch (mapnum) {
      case 0:
        display.drawBitmap(47, 23, space_heroes_logo, 34, 34, 1);
        break;
      case 1:
        display.drawBitmap(47, 23, cat_or_bread_logo, 34, 34, 1);
        break;
      case 2:
        display.drawBitmap(47, 23, tanchiki_logo, 34, 34, 1);
        break;
      case 3:
        display.drawBitmap(47, 23, phisics_logo, 34, 34, 1);
        break;
      case 4:
        display.setCursor(0, 30);
        display.print(utf8rus("  Портрет_путина.png"));
        break;
      case 5:
        display.setCursor(2, 30);
        display.print(utf8rus("Корова.mp4"));
        break;
      case 6:
        display.setCursor(2, 30);
        display.print(utf8rus(" Настройки"));
        break;
      case 7:
        display.drawBitmap(47, 23, lambda_logo, 34, 34, 1);
        break;
      case 8:
        display.drawBitmap(47, 23, beer_logo, 34, 34, 1);
        break;
      case 9:
        display.drawBitmap(47, 23, terminal_logo, 34, 34, 1);
        break;
      case 10:
        display.setCursor(40, 30);
        display.print("Pong");
        break;
      case 11:
        display.setCursor(10, 30);
        display.print(utf8rus("Карманный Ситин"));
        break;
      case 12:
        display.setCursor(10, 30);
        display.print(utf8rus("Metaballs"));
        break;
      case 13:
        display.setCursor(10, 30);
        display.print(utf8rus("Пианино"));
        break;
      case 14:
        display.setCursor(10, 30);
        display.print(utf8rus("Клавиатура"));
        break;
      case 15:
        display.setCursor(10, 30);
        display.print(utf8rus("KTube"));
        break;
      case 16:
        display.setCursor(10, 30);
        display.print(utf8rus("Servo"));
        break;

    }
    display.drawRect(0, 0, 128, 64 , 1);
    display.display();
    while (btn0 == !BTN && btn2 == !BTN && btn3 == !BTN) {
      btn0 = digitalRead(KEYLS);
      btn2 = digitalRead(KEYRC);
      btn3 = digitalRead(KEYRS);
    }
    if (btn0 == BTN) {
      mapnum--;
      if (mapnum < 0) {
        mapnum = APPS - 1;
      }
      btn0 = !BTN;
      delay(200);
    }
    else {
      if (btn2 == BTN) {
        mapnum++;
        if (mapnum > APPS - 1) {
          mapnum = 0;
        }
        btn2 = !BTN;
        delay(200);
      }
      else {
        if (btn3 == BTN) {
          enter = 1;
          btn3 = !BTN;
          delay(200);
        }
      }
    }

  }
  btn0 = !BTN;
  btn2 = !BTN;
  btn3 = !BTN;
  delay(300);
  display.clearDisplay();
  if (enter == 1) {
    if (mapnum == 0) {
      playSpace();
    }
    else if (mapnum == 1) {
      playCats();
    }
    else if (mapnum == 2) {
      //playMetaBalls();
      playTanks();
    }
    else if (mapnum == 3) {
      playPhisics();
    }
    else if (mapnum == 4) {
      display.clearDisplay();
      display.drawBitmap(0, 0, putina_portret, 128, 64, 1);
      display.display();
      delay(3000);
      display.clearDisplay();
      display.drawBitmap(0, 0, putina_portret_vtoroy, 128, 64, 1);
      display.display();
    }
    else if (mapnum == 5) {
      //rp2040.resumeOtherCore();

      while (1) {
        for (byte i = 0; i < 8; i++) {
          display.clearDisplay();
          display.drawBitmap(0, 0, cow[i], 128, 64, 1);
          display.display();
          delay(230);
        }
      }
    }
    else if (mapnum == 6) {
      playSettings();
    }
    else if (mapnum == 7) {        // Если пользователь выберет 10 приложение
      play3d();             // Запустим наше
    }
    else if (mapnum == 8) {
      playBeer();
    }
    else if (mapnum == 9) {
      //playKatafalk();
      //playFilm();
    }
    else if (mapnum == 10) {
      const char *menuMan[] = {"Вдвоем", "С копьютером", "Создать комнату", "Войти в комнату"};
      switch(korobkaMenu(4, menuMan)) {
        case 0:
          pong.play();
          break;
        case 1:
          pong.ai = true;
          pong.play();
          break;
        case 2:
          pong.playServer();
          break;
        case 3:
          pong.playClient();
          break;

      }

      //playFilm();
    }
    else if (mapnum == 11) {
      Sitin.play();
      //playFilm();
    }
    else if (mapnum == 12) {
      playMetaBalls();
      //playFilm();
    }
    else if (mapnum == 13) {
      playPiano();
      //playFilm();
    }
    else if (mapnum == 14) {
      board.play();
      //playFilm();
    }
    else if (mapnum == 15) {
      korobkaTube.play();
      //playFilm();
    }
    else if (mapnum == 16) {
      servoTester.play();
      //playFilm();
    }
  }


}

struct APP {
  String title;
  void (*execute)();
  const unsigned char* logo;
} ;

void sinLine(int x1,int y1,int len,float angle,bool color){
	int x2 = (x1 + (len * cos(angle)));
	int y2 = (y1 + (len * sin(angle)));
	display.drawLine(x1, y1, x2, y2, color);
}

void testPlay() {
  display.clearDisplay();
  float angle = 0;
  while(1){
    if(!digitalRead(KEYRC)){
      angle += 0.05;
      if(angle >= 0) angle = 0;
      display.clearDisplay();
      sinLine(64, 50, 20, angle*PI, 1);
      display.display();
      delay(50);
    }
    if(!digitalRead(KEYLS)){
      angle -= 0.05;
      if(angle <= -1) angle = -1;
      display.clearDisplay();
      sinLine(64, 50, 20, angle*PI, 1);
      display.display();
      delay(50);
    }
  }
}

struct {
  void play() {
    message("Connecting to WiFi...", 1);
    WiFi.mode(WIFI_STA);
    WiFi.begin(ssid.c_str(), password.c_str());
    while (WiFi.status() != WL_CONNECTED) {
      delay(100);
    }
    configTime(3600*3, 0, "pool.ntp.org");
    struct tm timeinfo;
    if(!getLocalTime(&timeinfo)){
      message("Can't get time", 1000);
    }
    WiFi.disconnect();
    while(true) {
      if(!getLocalTime(&timeinfo)){
        message("Can't get time", 1000);
      }
      else {
        message(String(asctime(&timeinfo)).c_str(), 1000);
      }
    }
  }
} watch;


void gameMenu() {
  int numOfApps = 16;

  int centerX = 64;

  int centerY = 55;

  int dst = 40;

  APP appList[numOfApps];

  appList[0].title = "Space Heroes";
  appList[0].execute = playSpace;
  appList[0].logo = space_heroes_logo;

  appList[1].title = "Cat or Bread";
  appList[1].execute = playCats;
  appList[1].logo = cat_or_bread_logo;

  appList[2].title = "Beer's";
  appList[2].execute = playBeer;
  appList[2].logo = beer_logo;

  appList[3].title = "Tanchiki";
  appList[3].execute = playTanks;
  appList[3].logo = tanchiki_logo;

  appList[4].title = "Записки";
  appList[4].execute = playPhisics;
  appList[4].logo = phisics_logo;

  appList[5].title = "Портрет Путина";
  appList[5].execute = []{
    display.clearDisplay();
    display.drawBitmap(0, 0, putina_portret, 128, 64, 1);
    display.display();
    delay(3000);
    display.clearDisplay();
    display.drawBitmap(0, 0, putina_portret_vtoroy, 128, 64, 1);
    display.display();
  };
  appList[5].logo = std_logo;

  appList[6].title = "Пианино";
  appList[6].execute = playPiano;
  appList[6].logo = piano_logo;

  appList[7].title = "Карманный Ситин";
  appList[7].execute = []{Sitin.play();};
  appList[7].logo = std_logo;

  appList[8].title = "Metaballs";
  appList[8].execute = playMetaBalls;
  appList[8].logo = std_logo;

  appList[9].title = "Korobochka Tube";
  appList[9].execute = []{korobkaTube.play();};
  appList[9].logo = korobkaTube_logo;

  appList[10].title = "Pong";
  appList[10].execute = []{
    const char *menuMan[] = {"Вдвоем", "С копьютером", "Создать комнату", "Войти в комнату"};
    switch(korobkaMenu(4, menuMan)) {
      case 0:
        pong.play();
        break;
      case 1:
        pong.ai = true;
        pong.play();
        break;
      case 2:
        pong.playServer();
        break;
      case 3:
        pong.playClient();
        break;
    }
  };
  appList[10].logo = std_logo;

  appList[11].title = "Настройки";
  appList[11].execute = playSettings;
  appList[11].logo = std_logo;

  appList[12].title = "Гос DooM'а";
  appList[12].execute = play3d;
  appList[12].logo = lambda_logo;

  appList[13].title = "Польская Корова";
  appList[13].execute = []{
    while (1) {
      for (byte i = 0; i < 8; i++) {
        display.clearDisplay();
        display.drawBitmap(0, 0, cow[i], 128, 64, 1);
        display.display();
        delay(230);
      }
    }
  };
  appList[13].logo = std_logo;

  appList[14].title = "Часы";
  appList[14].execute = []{
    watch.play();
  };
  appList[14].logo = watch_logo;

  appList[15].title = "Клавиатура";
  appList[15].execute = []{
    board.play();
  };
  appList[15].logo = std_logo;
/*
  appList[15].title = "Тестирование";
  appList[15].execute = []{
    Wire.begin();
    Wire.beginTransmission(60);
    byte cmode = 0x00;
    byte command = 0xAE;
    Wire.write(cmode);
    Wire.write(command);
    Wire.endTransmission();
  };
  appList[15].logo = watch_logo;
*/

  int mapnum = 0;

  int inwork[3] = {numOfApps - 1, 0, 1};

  float angle = -0.5;

  display.drawBitmap(centerX + (dst * cos((angle-0.5)*PI)) - 17, centerY + (dst * sin((angle-0.5)*PI)), appList[inwork[0]].logo, 34, 34, 1);
  display.drawBitmap(centerX + (dst * cos(angle*PI)) - 17, centerY + (dst * sin(angle*PI)), appList[inwork[1]].logo, 34, 34, 1);
  display.drawBitmap(centerX + (dst * cos((angle+0.5)*PI)) - 17, centerY + (dst * sin((angle+0.5)*PI)), appList[inwork[2]].logo, 34, 34, 1);
  display.setCursor(centerX-utf8rus(appList[mapnum].title).length()*3, 0);
  display.print(utf8rus(appList[mapnum].title));
  display.display();



  while(digitalRead(KEYRS)) {
    delay(5);
    if(!digitalRead(KEYRC)){
      mapnum--;
      if(mapnum < 0) mapnum = numOfApps - 1;
      for(angle = -0.5; angle <=-0.25; angle+=0.125) {
        display.clearDisplay();
        display.drawBitmap(centerX + (dst * cos((angle-0.5)*PI)) - 17, centerY + (dst * sin((angle-0.5)*PI)), appList[inwork[0]].logo, 34, 34, 1);
        display.drawBitmap(centerX + (dst * cos(angle*PI)) - 17, centerY + (dst * sin(angle*PI)), appList[inwork[1]].logo, 34, 34, 1);
        display.drawBitmap(centerX + (dst * cos((angle+0.5)*PI)) - 17, centerY + (dst * sin((angle+0.5)*PI)), appList[inwork[2]].logo, 34, 34, 1);
        display.display();
      }
      for(int i = 0; i<3; i++){
        inwork[i]--;
        if(inwork[i]<0) inwork[i] = numOfApps - 1;
      }
      angle = -0.75;
      for(angle = -0.75; angle <=-0.5; angle+=0.125) {
        display.clearDisplay();
        display.drawBitmap(centerX + (dst * cos((angle-0.5)*PI)) - 17, centerY + (dst * sin((angle-0.5)*PI)), appList[inwork[0]].logo, 34, 34, 1);
        display.drawBitmap(centerX + (dst * cos(angle*PI)) - 17, centerY + (dst * sin(angle*PI)), appList[inwork[1]].logo, 34, 34, 1);
        display.drawBitmap(centerX + (dst * cos((angle+0.5)*PI)) - 17, centerY + (dst * sin((angle+0.5)*PI)), appList[inwork[2]].logo, 34, 34, 1);
        display.display();
      }
      angle = -0.5;
      display.setCursor(centerX-utf8rus(appList[mapnum].title).length()*3, 0);
      display.print(utf8rus(appList[mapnum].title));
      display.display();
    }
    if(!digitalRead(KEYLS)){
      mapnum++;
      if(mapnum >= numOfApps) mapnum = 0;
      for(angle = -0.5; angle >=-0.75; angle-=0.125) {
        display.clearDisplay();
        display.drawBitmap(centerX + (dst * cos((angle-0.5)*PI)) - 17, centerY + (dst * sin((angle-0.5)*PI)), appList[inwork[0]].logo, 34, 34, 1);
        display.drawBitmap(centerX + (dst * cos(angle*PI)) - 17, centerY + (dst * sin(angle*PI)), appList[inwork[1]].logo, 34, 34, 1);
        display.drawBitmap(centerX + (dst * cos((angle+0.5)*PI)) - 17, centerY + (dst * sin((angle+0.5)*PI)), appList[inwork[2]].logo, 34, 34, 1);
        display.display();
      }
      for(int i = 0; i<3; i++){
        inwork[i]++;
        if(inwork[i]>=numOfApps) inwork[i] = 0;
      }
      angle = -0.25;
      for(angle = -0.25; angle >=-0.5; angle-=0.125) {
        display.clearDisplay();
        display.drawBitmap(centerX + (dst * cos((angle-0.5)*PI)) - 17, centerY + (dst * sin((angle-0.5)*PI)), appList[inwork[0]].logo, 34, 34, 1);
        display.drawBitmap(centerX + (dst * cos(angle*PI)) - 17, centerY + (dst * sin(angle*PI)), appList[inwork[1]].logo, 34, 34, 1);
        display.drawBitmap(centerX + (dst * cos((angle+0.5)*PI)) - 17, centerY + (dst * sin((angle+0.5)*PI)), appList[inwork[2]].logo, 34, 34, 1);
        display.display();
      }
      angle = -0.5;
      display.setCursor(centerX-utf8rus(appList[mapnum].title).length()*3, 0);
      display.print(utf8rus(appList[mapnum].title));
      display.display();
    }
    /*
    if(!digitalRead(KEYRC)){
      mapnum++;
      if(mapnum >= numOfApps) mapnum = 0;
      display.clearDisplay();
      display.drawBitmap(0, 0, appList[mapnum].logo, 34, 34, 1);
      display.display();
      delay(200);
    }
*/
  }
  for(int i = 36; i <= 44; i+=2) {
    if(i != 36) display.drawRoundRect(centerX-(i-2)/2, centerY-dst+17-(i-2)/2, i-2, i-2, 10, 0);
    display.drawRoundRect(centerX-i/2, centerY-dst+17-i/2, i, i, 10, 1);
    display.display();
    delay(30);
  }
  display.clearDisplay();
  appList[mapnum].execute();
}

IPAddress IP;

struct {
  void update() {
    display.setTextSize(1);
    display.setCursor(5, 5);
    display.print("  Firmware upload!");
    display.setCursor(5, 45);
    display.println("Connecting to ");
    display.print(ssid);
    display.display();
    WiFi.mode(WIFI_STA);
    WiFi.begin(ssid.c_str(), password.c_str());
    while (WiFi.status() != WL_CONNECTED) {
      delay(100);
    }
    IP = WiFi.localIP();

    ArduinoOTA
    .onStart([]() {
      String type;
      if (ArduinoOTA.getCommand() == U_FLASH)
        type = "sketch";
      else // U_SPIFFS
        type = "filesystem";

      // NOTE: if updating SPIFFS this would be the place to unmount SPIFFS using SPIFFS.end()
      Serial.println("Start updating " + type);
      display.clearDisplay();
      display.setTextSize(2);
      display.setCursor(10, 10);
      display.print("Updating");
      display.drawRect(12, 40, 104, 10, 1);
    })
    .onEnd([]() {
      Serial.println("\nEnd");
    })
    .onProgress([](unsigned int progress, unsigned int total) {
      Serial.printf("Progress: %u%%\r", (progress / (total / 100)));
      display.fillRect(14, 42, (progress / (total / 100)), 6, 1);
      display.display();
    })
    .onError([](ota_error_t error) {
      Serial.printf("Error[%u]: ", error);
      if (error == OTA_AUTH_ERROR) message("Auth Failed", 1000);
      else if (error == OTA_BEGIN_ERROR) message("Begin Failed", 1000);
      else if (error == OTA_CONNECT_ERROR) message("Connect Failed", 1000);
      else if (error == OTA_RECEIVE_ERROR) message("Receive Failed", 1000);
      else if (error == OTA_END_ERROR) message("End Failed", 1000);
    });

    ArduinoOTA.begin();

    display.clearDisplay();
    display.setCursor(5, 5);
    display.print("  Firmware upload!");
    display.setCursor(5, 45);
    display.print("IP: ");
    display.print(IP);
    display.display();
    while (1) ArduinoOTA.handle();
  }
} arduinoOTA;

void update_started() {
  display.clearDisplay();
  display.setTextSize(1);
  display.setCursor(10, 5);
  display.print("Updates download");
  display.drawRect(12, 40, 104, 10, 1);
  display.display();
}

void update_progress(int cur, int total) {
  display.fillRect(14, 42, (cur / (total / 100)), 6, 1);
  display.display();
}

struct {
  const char* rootCACertificate =
      "-----BEGIN CERTIFICATE-----\n"
      "MIIHFDCCBfygAwIBAgIQCLS/dX/bKN3zuMTJNXxaSTANBgkqhkiG9w0BAQsFADBP\n"
      "MQswCQYDVQQGEwJVUzEVMBMGA1UEChMMRGlnaUNlcnQgSW5jMSkwJwYDVQQDEyBE\n"
      "aWdpQ2VydCBUTFMgUlNBIFNIQTI1NiAyMDIwIENBMTAeFw0yMjA0MDcwMDAwMDBa\n"
      "Fw0yMzA0MDcyMzU5NTlaMGgxCzAJBgNVBAYTAlVTMRMwEQYDVQQIEwpDYWxpZm9y\n"
      "bmlhMRYwFAYDVQQHEw1TYW4gRnJhbmNpc2NvMRUwEwYDVQQKEwxHaXRIdWIsIElu\n"
      "Yy4xFTATBgNVBAMMDCouZ2l0aHViLmNvbTCCASIwDQYJKoZIhvcNAQEBBQADggEP\n"
      "ADCCAQoCggEBALyqZjatk2jnqiWmp6eusW70yJlreKz8mllyRSPxnIVeuwCHGzeQ\n"
      "pGOOZkdRiBLcC2SWM3WgwQjBVBzqS1hWgoP5e6hzuXvGM3anlgJDE9dDUJfdC/Is\n"
      "nzB4Q5Y4TU3FcRCUaK4GMoJGC0fu0fDbH927yKAnvdErG4u+jFSqIidwEaEfPWCC\n"
      "o3xCyQLHTknXQ9aaDvU6GHNX0us6G+bjdErIwQtC56F0ke7biV0A/DWX5V+hVsVY\n"
      "jY9JbYNx+KFjmUxLibccXzXs0pJ+a6Xa4OhhrFebPwS+SQA+gxTTvZotj4J5kf2l\n"
      "nM9H+1whu6I5qPebhlTRTKpxdPm9V647Zj8CAwEAAaOCA9EwggPNMB8GA1UdIwQY\n"
      "MBaAFLdrouqoqoSMeeq02g+YssWVdrn0MB0GA1UdDgQWBBRWmrM0shNZi0idiZiI\n"
      "7l3ryIMwdDB7BgNVHREEdDByggwqLmdpdGh1Yi5jb22CDnd3dy5naXRodWIuY29t\n"
      "gglnaXRodWIuaW+CCmdpdGh1Yi5jb22CCyouZ2l0aHViLmlvghVnaXRodWJ1c2Vy\n"
      "Y29udGVudC5jb22CFyouZ2l0aHVidXNlcmNvbnRlbnQuY29tMA4GA1UdDwEB/wQE\n"
      "AwIFoDAdBgNVHSUEFjAUBggrBgEFBQcDAQYIKwYBBQUHAwIwgY8GA1UdHwSBhzCB\n"
      "hDBAoD6gPIY6aHR0cDovL2NybDMuZGlnaWNlcnQuY29tL0RpZ2lDZXJ0VExTUlNB\n"
      "U0hBMjU2MjAyMENBMS00LmNybDBAoD6gPIY6aHR0cDovL2NybDQuZGlnaWNlcnQu\n"
      "Y29tL0RpZ2lDZXJ0VExTUlNBU0hBMjU2MjAyMENBMS00LmNybDA+BgNVHSAENzA1\n"
      "MDMGBmeBDAECAjApMCcGCCsGAQUFBwIBFhtodHRwOi8vd3d3LmRpZ2ljZXJ0LmNv\n"
      "bS9DUFMwfwYIKwYBBQUHAQEEczBxMCQGCCsGAQUFBzABhhhodHRwOi8vb2NzcC5k\n"
      "aWdpY2VydC5jb20wSQYIKwYBBQUHMAKGPWh0dHA6Ly9jYWNlcnRzLmRpZ2ljZXJ0\n"
      "LmNvbS9EaWdpQ2VydFRMU1JTQVNIQTI1NjIwMjBDQTEtMS5jcnQwCQYDVR0TBAIw\n"
      "ADCCAX8GCisGAQQB1nkCBAIEggFvBIIBawFpAHYA6D7Q2j71BjUy51covIlryQPT\n"
      "y9ERa+zraeF3fW0GvW4AAAGABfvdbAAABAMARzBFAiAGLk49aFP9ARwPXCa59WnI\n"
      "f5jIU5eFmqR6/W3Zm38KiwIhAIp8FySKqbKk600uO4iPsS6TW8hJl67PprwXYMlr\n"
      "o3wPAHcANc8ZG7+xbFe/D61MbULLu7YnICZR6j/hKu+oA8M71kwAAAGABfvdXQAA\n"
      "BAMASDBGAiEAjFarHnzcbBvQ8//um0zVd4G3T5zbW4XSUIJSTc5JGo8CIQDaT5K8\n"
      "pji9egTYSypP9XfRK+Z2wID3j43uuGjiKSOKyQB2ALNzdwfhhFD4Y4bWBancEQlK\n"
      "eS2xZwwLh9zwAw55NqWaAAABgAX73YsAAAQDAEcwRQIhAO/PWksY7Zd7W5NJr3e4\n"
      "xRkx8J6Qv7a33VA3tkm96k4WAiBshJWPE2BjKzuQ/KEfiKnvD4dDa3btkmcWlpiD\n"
      "R8AvQDANBgkqhkiG9w0BAQsFAAOCAQEARtY8iVMqqBCXGZj2NRhpxA4eS2b/e/56\n"
      "JhnRWGz3wxf0aRjbaZ2sUH3aHe1UDyg4jVPgnSLsGnBMmN5Rk32uiB/5v6/uRhCa\n"
      "l26Yi9MYbeQpt0980MxT5hhv8bThRiNa77+oAOcrYMJEGIf2/9k0yoefblEZTR02\n"
      "6UU6pkDhxjMtpyNRr+IdqQM/4lCM6nu8FZ/qaLltvta1Enq+jEwEObo/PoBoQJzJ\n"
      "j7hcu7rkyPQIK1raQ9pK7uFJ2/FgtxIUuT+by06LnUp82VB7QxlniXO2R4XgDzWd\n"
      "umlpkAFJQvZ+Sa2rSdjynrTDedjQIv3s1jH2Tvao5fR23tW2XAQhVg==\n"
      "-----END CERTIFICATE-----\n"
      "-----BEGIN CERTIFICATE-----\n"
      "MIIEvjCCA6agAwIBAgIQBtjZBNVYQ0b2ii+nVCJ+xDANBgkqhkiG9w0BAQsFADBh\n"
      "MQswCQYDVQQGEwJVUzEVMBMGA1UEChMMRGlnaUNlcnQgSW5jMRkwFwYDVQQLExB3\n"
      "d3cuZGlnaWNlcnQuY29tMSAwHgYDVQQDExdEaWdpQ2VydCBHbG9iYWwgUm9vdCBD\n"
      "QTAeFw0yMTA0MTQwMDAwMDBaFw0zMTA0MTMyMzU5NTlaME8xCzAJBgNVBAYTAlVT\n"
      "MRUwEwYDVQQKEwxEaWdpQ2VydCBJbmMxKTAnBgNVBAMTIERpZ2lDZXJ0IFRMUyBS\n"
      "U0EgU0hBMjU2IDIwMjAgQ0ExMIIBIjANBgkqhkiG9w0BAQEFAAOCAQ8AMIIBCgKC\n"
      "AQEAwUuzZUdwvN1PWNvsnO3DZuUfMRNUrUpmRh8sCuxkB+Uu3Ny5CiDt3+PE0J6a\n"
      "qXodgojlEVbbHp9YwlHnLDQNLtKS4VbL8Xlfs7uHyiUDe5pSQWYQYE9XE0nw6Ddn\n"
      "g9/n00tnTCJRpt8OmRDtV1F0JuJ9x8piLhMbfyOIJVNvwTRYAIuE//i+p1hJInuW\n"
      "raKImxW8oHzf6VGo1bDtN+I2tIJLYrVJmuzHZ9bjPvXj1hJeRPG/cUJ9WIQDgLGB\n"
      "Afr5yjK7tI4nhyfFK3TUqNaX3sNk+crOU6JWvHgXjkkDKa77SU+kFbnO8lwZV21r\n"
      "eacroicgE7XQPUDTITAHk+qZ9QIDAQABo4IBgjCCAX4wEgYDVR0TAQH/BAgwBgEB\n"
      "/wIBADAdBgNVHQ4EFgQUt2ui6qiqhIx56rTaD5iyxZV2ufQwHwYDVR0jBBgwFoAU\n"
      "A95QNVbRTLtm8KPiGxvDl7I90VUwDgYDVR0PAQH/BAQDAgGGMB0GA1UdJQQWMBQG\n"
      "CCsGAQUFBwMBBggrBgEFBQcDAjB2BggrBgEFBQcBAQRqMGgwJAYIKwYBBQUHMAGG\n"
      "GGh0dHA6Ly9vY3NwLmRpZ2ljZXJ0LmNvbTBABggrBgEFBQcwAoY0aHR0cDovL2Nh\n"
      "Y2VydHMuZGlnaWNlcnQuY29tL0RpZ2lDZXJ0R2xvYmFsUm9vdENBLmNydDBCBgNV\n"
      "HR8EOzA5MDegNaAzhjFodHRwOi8vY3JsMy5kaWdpY2VydC5jb20vRGlnaUNlcnRH\n"
      "bG9iYWxSb290Q0EuY3JsMD0GA1UdIAQ2MDQwCwYJYIZIAYb9bAIBMAcGBWeBDAEB\n"
      "MAgGBmeBDAECATAIBgZngQwBAgIwCAYGZ4EMAQIDMA0GCSqGSIb3DQEBCwUAA4IB\n"
      "AQCAMs5eC91uWg0Kr+HWhMvAjvqFcO3aXbMM9yt1QP6FCvrzMXi3cEsaiVi6gL3z\n"
      "ax3pfs8LulicWdSQ0/1s/dCYbbdxglvPbQtaCdB73sRD2Cqk3p5BJl+7j5nL3a7h\n"
      "qG+fh/50tx8bIKuxT8b1Z11dmzzp/2n3YWzW2fP9NsarA4h20ksudYbj/NhVfSbC\n"
      "EXffPgK2fPOre3qGNm+499iTcc+G33Mw+nur7SpZyEKEOxEXGlLzyQ4UfaJbcme6\n"
      "ce1XR2bFuAJKZTRei9AqPCCcUZlM51Ke92sRKw2Sfh3oius2FkOH6ipjv3U/697E\n"
      "A7sKPPcw7+uvTPyLNhBzPvOk\n"
      "-----END CERTIFICATE-----\n";

  void setClock() {
    configTime(0, 0, "pool.ntp.org", "time.nist.gov");  // UTC
    time_t now = time(nullptr);
    while (now < 8 * 3600 * 2) {
      yield();
      delay(500);
      Serial.print(F("."));
      now = time(nullptr);
    }
    struct tm timeinfo;
    gmtime_r(&now, &timeinfo);
    Serial.print(asctime(&timeinfo));
  }
  //String server = "http://192.168.1.98:8000/Korobochka.ino.esp32c3.bin";
  String server_repositories = "https://efim-sys.github.io/Korobochka/repositories";
  String server = "https://efim-sys.github.io/Korobochka/Korobochka.ino.esp32c3.bin";
  void update() {
    display.clearDisplay();
    display.setTextSize(1);
    display.setCursor(10, 5);
    display.print("Updates download");
    display.setCursor(5, 45);
    display.println("Connecting to ");
    display.print(utf8rus(ssid));
    display.display();
    WiFi.mode(WIFI_STA);
    WiFi.begin(ssid.c_str(), password.c_str());
    while (WiFi.status() != WL_CONNECTED) {
      delay(100);
    }
    IP = WiFi.localIP();

    display.clearDisplay();
    display.setCursor(10, 5);
    display.print("Updates download");
    display.setCursor(0, 45);
    display.print("Update repositories");
    //display.print(IP);
    display.display();
    httpUpdate.onStart(update_started);
    httpUpdate.onProgress(update_progress);

    setClock();

    wificlient.setCACert(rootCACertificate);

    wificlient.setTimeout(12000 / 1000);
    HTTPClient https;
    https.begin(server_repositories.c_str());
    if(https.GET() > 0) {
      String payload = https.getString();
      int countVideos = payload.substring(0, payload.indexOf('\n')).toInt();
      payload.remove(0, payload.indexOf('\n')+1);
      
      if(!SPIFFS.begin()) message("SPIFFS begin fault", 1000);
      File f = SPIFFS.open(F("/user_repo"), "r");
      String user_repo = f.readString();
      f.close();

      bool has_user_repo = user_repo.length() > 1;
      
      struct {
        String name;
        String url;
      } props[countVideos + has_user_repo];

      const char *vidMenu[countVideos + has_user_repo];

      if(has_user_repo) {
        vidMenu[countVideos] = user_repo.length() > 18 ? user_repo.substring(0, 18).c_str() : user_repo.c_str();
        props[countVideos].url = user_repo;
      }

      for(int i = 0; i < countVideos; i++){
        props[i].name = payload.substring(0, payload.indexOf('\n'));
        vidMenu[i] = props[i].name.c_str();
        payload.remove(0, payload.indexOf('\n')+1);
        props[i].url = payload.substring(0, payload.indexOf('\n'));
        payload.remove(0, payload.indexOf('\n')+1);
      }

      byte n = korobkaMenu(countVideos + has_user_repo, vidMenu);
      
      server = props[n].url;
    }
    else message("Failed getting repositories. Trying official repository...", 3000);

    httpUpdate.update(wificlient, server.c_str());
    message(httpUpdate.getLastErrorString().c_str(), 3000);
  }
} updaterOTA;


void setup() {
  ledcSetup(0, 0, 8);
  ledcAttachPin(5, 0);
  ledcWrite(0, 125);
  EEPROM.begin(256);

  Wire.begin(9, 10);
  if(!SPIFFS.begin(true)) message("SPIFFS init fail", 1000);
  File wpa_ssid = SPIFFS.open(F("/wpa_ssid"), "r");
  File wpa_pass = SPIFFS.open(F("/wpa_pass"), "r");
  if(!wpa_pass) message("file open fail", 1000);

  ssid = wpa_ssid.readString();
  password = wpa_pass.readString();

  String hostname = "Korobochka " + String(WiFi.macAddress()).substring(15);
  Serial.begin(115200);
  Serial.println("Starting Korobochka");
  WiFi.setHostname(hostname.c_str());
  pinMode(KEYLS, INPUT_PULLUP);
  pinMode(KEYLC, INPUT_PULLUP);
  pinMode(KEYRC, INPUT_PULLUP);
  pinMode(KEYRS, INPUT_PULLUP);
  ledcSetup(TONEPIN, 300, 255);
  randomSeed(analogRead(36));
  display.begin(SSD1306_SWITCHCAPVCC, 0x3C);
  display.dim(0);
  display.cp437(true);
  display.setRotation(0);
  display.fillScreen(0);
  display.setTextColor(1, 0);
  display.clearDisplay();
  if (!digitalRead(KEYOTA)) {
    arduinoOTA.update();
  }

  gameMenu();
  display.clearDisplay();

}

void loop() {

}



byte korobkaMenu(byte lenght, const char *elements[]) {
  display.setFont();
  int mapnum = 0;
  while (1) {
    display.clearDisplay();
    display.setTextSize(1);
    display.setCursor(0, 0);
    for (byte i = 0; i < lenght; i++) {

      display.print("  ");
      display.println(utf8rus(elements[i]));
    }
    display.setCursor(0, 8 * mapnum);
    display.print(">");
    display.display();
    bool up = !BTN;
    bool down = !BTN;
    bool enter = !BTN;
    while (up == !BTN and down == !BTN and enter == !BTN) {
      up = digitalRead(KEYLS);
      down = digitalRead(KEYRC);
      enter = digitalRead(KEYRS);
    }
    if (up == BTN) mapnum--; if (mapnum < 0) mapnum = lenght - 1; delay(100);
    if (down == BTN) mapnum++; if (mapnum > lenght - 1) mapnum = 0; delay(100);
    if (enter  == BTN) break;
  }
  delay(200);
  return mapnum;
}

byte korobkaMenuString(byte lenght, String elements[]) {
  display.setFont();
  int mapnum = 0;
  while (1) {
    display.clearDisplay();
    display.setTextSize(1);
    display.setCursor(0, 0);
    for (byte i = 0; i < lenght; i++) {

      display.print("  ");
      display.println(utf8rus(elements[i]));
    }
    display.setCursor(0, 8 * mapnum);
    display.print(">");
    display.display();
    bool up = !BTN;
    bool down = !BTN;
    bool enter = !BTN;
    while (up == !BTN and down == !BTN and enter == !BTN) {
      up = digitalRead(KEYLS);
      down = digitalRead(KEYRC);
      enter = digitalRead(KEYRS);
    }
    if (up == BTN) mapnum--; if (mapnum < 0) mapnum = lenght - 1; delay(100);
    if (down == BTN) mapnum++; if (mapnum > lenght - 1) mapnum = 0; delay(100);
    if (enter  == BTN) break;
  }
  delay(200);
  return mapnum;
}



int korobkaInput(int mini, int maxi, int stepi, int def) {
  display.setFont();
  int mapnum = def;
  while (1) {
    display.clearDisplay();
    display.setTextSize(2);
    display.drawRoundRect(15, 15, 98, 25, 5, 1);
    display.setCursor(19, 19);
    display.print(mapnum);
    display.display();
    bool up = !BTN;
    bool down = !BTN;
    bool enter = !BTN;
    while (up == !BTN and down == !BTN and enter == !BTN) {
      up = digitalRead(KEYLS);
      down = digitalRead(KEYRC);
      enter = digitalRead(KEYRS);
    }
    if (up == BTN) mapnum -= stepi; if (mapnum < mini) mapnum = maxi - 1; delay(100);
    if (down == BTN) mapnum += stepi; if (mapnum > maxi - 1) mapnum = mini; delay(100);
    if (enter == BTN) break;
  }
  delay(200);
  return mapnum;
}

bool writeInt(int addr, int data) {
  EEPROM.write(addr, data / 256);
  EEPROM.write(addr + 1, data % 256);
  return EEPROM.commit();
}

int readInt(int addr) {
  return EEPROM.read(addr) * 256 + EEPROM.read(addr + 1);
}

struct {
  int choice = 0;

  struct Argument {
    int value = 50;
    int max;
    int min = 0;
    int multiply = 10;
  };

  Argument args[2]; //freq duty

  void draw() {
    display.clearDisplay();
    display.setCursor(0, 0);
    display.setTextSize(2);
    display.print(args[1].value);
    display.setTextSize(1);
    display.setCursor(0, 50);
    display.print(args[0].value);
    display.display();
  }

  void play() {
    args[0].value = 100;
    args[0].max = 10000;

    args[1].max = 255;
    ledcSetup(0, args[0].value, 8);
    ledcAttachPin(5, 0);
    ledcWrite(0, args[1].value);
    draw();
    while(true) {
      int change = 0;
      while(change == 0) {
        if(digitalRead(!KEYRS)) {
          choice = (choice + 1) % 2;
          draw();
        }
        if(digitalRead(!KEYRC)) change += 1;
        else if(digitalRead(!KEYLS)) change -= 1;
      }
      if((args[choice].value + change * args[choice].multiply) >= args[choice].min && (args[choice].value + change * args[choice].multiply) <= args[choice].max) {
        args[choice].value += args[choice].value + change * args[choice].multiply;
        draw();
        if(choice) ledcWrite(0, args[choice].value);
        else ledcSetup(0, args[choice].value, 8);
      }
    }
  }
} generator;

void playSettings() {
  while (1) {
    switch (korobkaMenu(5, settings)) {
      case 0:
          {byte key = korobkaMenu(4, keys);
          int freq = notes[korobkaMenu(8, note_names)];
          writeInt(key * 2 + 4, freq);
          message("Saved!", 400);}
          break;
      case 1:
          {int count = korobkaInput(80, 401, 5, readInt(2));
          writeInt(2, count);
          message("Saved!", 400);}
          break;

      case 2: {
        display.clearDisplay();
        display.setCursor(0, 0);
        display.setTextSize(1);
        WiFi.mode(WIFI_MODE_STA);
        display.println(WiFi.macAddress());
        display.println("Build datetime: ");
        display.println(String(__DATE__) + " " + String(__TIME__));
        display.display();
        while(1);
      }
        break;
      case 3: {
        const char* tools[] = {"MLX90614 t-metr", "ROM-tool", "WiFi подключение", "I2C scanner", "Осцилограф", "Генератор PWM", "Свой репозиторий"};
        switch (korobkaMenu(7, tools)) {
          case 0:
            {thermo_type = 0;
            playThermometer();}
            break;
          case 1:
            {if (korobkaInput(0, 1000, 10, 500) == ROM_PASSWD) {
              message("pass OK!", 400);
              message("ROM addr:", 400);
              int addr = korobkaInput(0, 256, 1, 0);
              message("Data:", 400);
              EEPROM.write(addr, korobkaInput(0, 256, 1, EEPROM.read(addr)));
              EEPROM.commit();
              message("Saved!", 400);
            }
            else {
              message("wrong pass", 400);
            }}
            break;
          case 2:
            {
            message("Поиск", 1);
            int n = WiFi.scanNetworks();
            display.clearDisplay();
            display.setCursor(0, 0);
            display.setTextSize(1);
            if(n > 8) n = 8;
            String nets[n];
            for (int i = 0; i < n; ++i) {
              nets[i] = WiFi.SSID(i);
            }
            n = korobkaMenuString(n, nets);
            String password = korobkaKeyboard.play();
            if(!SPIFFS.begin(true)) message("SPIFFS init fail", 1000);
            File wpa_ssid = SPIFFS.open(F("/wpa_ssid"), "w");
            File wpa_pass = SPIFFS.open(F("/wpa_pass"), "w");
            if(!wpa_ssid) message("file open fail", 1000);
            if(!wpa_ssid.print(WiFi.SSID(n))) message("writing fail", 1000);
            wpa_pass.print(password);
            wpa_ssid.close();
            wpa_pass.close();
            delay(100);
            ESP.restart();}
            break;
          case 3:
            {Wire.begin();
            display.clearDisplay();
            display.setCursor(0, 0);
            display.setTextSize(1);
            for (byte i = 8; i < 120; i++) {
              Wire.beginTransmission(i);
              if(Wire.endTransmission() == 0) display.println(String(i, HEX));
            }
            display.display();
            while(1);}
            break;
          case 4:
            {
            display.clearDisplay();
            display.setTextSize(1);
            long int tmr = millis();
            int gSpeed = 200;
            while(1) {
              if(millis() - tmr > gSpeed){
                graphVoltmeter();
                tmr = millis();
              }
              delay(1);
              if(digitalRead(KEYRS)) gSpeed++;
              if(digitalRead(KEYLS)) gSpeed--;
            };}
            break;
            case 5:
              {
              generator.play();}
              break;
            case 6:
              {
                if(!SPIFFS.begin()) message("SPIFFS begin fault", 1000);
                File f = SPIFFS.open(F("/user_repo"), "r");
                if(!f) message("file open fault", 1000);
                String e = f.readString();
                f.close();
                f = SPIFFS.open(F("/user_repo"), "w");
                message(e.c_str(), 1000);
                String a = korobkaKeyboard.play(e);
                if(!f.print(a)) message("SPIFFS write fault", 1000);;
                
              }
              break;
          }
        }
          break;
        case 4:
        {
          updaterOTA.update();
        }
        break;
        }



    }
  }


void message(const char* mes, int dlay) {
  display.clearDisplay();
  display.setFont();
  display.setCursor(0, 0);
  display.setTextSize(1);
  display.print(utf8rus(mes));
  display.display();
  delay(dlay);
}

void korobkaReader(const char* file[], int lenght) {
  display.setFont();
  display.clearDisplay();
  display.setTextSize(1);
  display.setCursor(0, 0);
  display.print(F("KorobkaReader 1.0\nis loading..."));
  display.display();
  delay(150);
  int mapnum = 0;
  while (1) {
    display.clearDisplay();
    display.setCursor(0, 0);
    display.print(utf8rus(file[mapnum]));
    display.display();
    bool up = !BTN;
    bool down = !BTN;
    while (up == !BTN and down == !BTN) {
      up = digitalRead(KEYLS);
      down = digitalRead(KEYRC);
    }
    if (up == BTN) mapnum --; if (mapnum < 0) mapnum = lenght - 1; delay(100);
    if (down == BTN) mapnum ++; if (mapnum > lenght - 1) mapnum = 0; delay(100);
    delay(200);
  }
}
