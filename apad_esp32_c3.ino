#include<Adafruit_GFX.h>
#include<Adafruit_SSD1306.h>
//#include <Adafruit_MLX90614.h>
//#include <Fonts/FreeMonoOblique12pt7b.h>
#include <EEPROM.h>
#include<Vector.h>
#include <WiFi.h>
//#include <ESPmDNS.h>
//#include <WiFiUdp.h>
#include <ArduinoOTA.h>
#include <HTTPClient.h>

const char* ssid = "spynet-2.4g";
const char* password = "MW9pDbkK";

/*
  #include <WebSerial.h>
  #include <WiFi.h>
  #include <AsyncTCP.h>
  #include <ESPAsyncWebServer.h>
  #include <AsyncElegantOTA.h>

  AsyncWebServer server(80);

  const char* APssid = "KorobochkaWiFi";
  const char* APpassword = "12345678";
*/

#define BTN 0

#define APPS 10  // Для 8 приложений на Korobochka

#define KEYRS 4
#define KEYRC 3
#define KEYLC 2
#define KEYLS 1
#define KEYOTA 2

#define TONEPIN 6

#define ROM_PASSWD 730

#define OLED_RESET 7

#define VERSION "1.33"

Adafruit_SSD1306 display(128, 64, &Wire, OLED_RESET);
//Adafruit_MLX90614 mlx = Adafruit_MLX90614();


const unsigned char mycow1 [] PROGMEM = {
  // 'mycow1, 128x64px
  0xff, 0xff, 0xff, 0xff, 0xff, 0xff, 0xff, 0xff, 0xff, 0xff, 0xff, 0xff, 0xff, 0xff, 0xff, 0xff,
  0xff, 0xff, 0xff, 0xff, 0xff, 0xff, 0xff, 0xff, 0xff, 0xff, 0xff, 0xff, 0xff, 0xff, 0xff, 0xff,
  0xff, 0xff, 0xff, 0xff, 0xff, 0xff, 0xff, 0xff, 0xff, 0xff, 0xff, 0xff, 0xff, 0xff, 0xff, 0xff,
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  0xff, 0xff, 0xff, 0xff, 0xff, 0xff, 0xff, 0xff, 0xff, 0xff, 0xff, 0xff, 0xff, 0xff, 0xff, 0xff
};

const unsigned char mycow2 [] PROGMEM = {
  // 'mycow2, 128x64px
  0xff, 0xff, 0xff, 0xff, 0xff, 0xff, 0xff, 0xff, 0xff, 0xff, 0xff, 0xff, 0xff, 0xff, 0xff, 0xff,
  0xff, 0xff, 0xff, 0xff, 0xff, 0xff, 0xff, 0xff, 0xff, 0xff, 0xff, 0xff, 0xff, 0xff, 0xff, 0xff,
  0xff, 0xff, 0xff, 0xff, 0xff, 0xff, 0xff, 0xff, 0xff, 0xff, 0xff, 0xff, 0xff, 0xff, 0xff, 0xff,
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  0xff, 0xff, 0xff, 0xff, 0xff, 0xff, 0xff, 0xff, 0xff, 0xff, 0xff, 0xff, 0xff, 0xff, 0xff, 0xff
};

const unsigned char mycow3 [] PROGMEM = {
  // 'mycow3, 128x64px
  0xff, 0xff, 0xff, 0xff, 0xff, 0xff, 0xff, 0xff, 0xff, 0xff, 0xff, 0xff, 0xff, 0xff, 0xff, 0xff,
  0xff, 0xff, 0xff, 0xff, 0xff, 0xff, 0xff, 0xff, 0xff, 0xff, 0xff, 0xff, 0xff, 0xff, 0xff, 0xff,
  0xff, 0xff, 0xff, 0xff, 0xff, 0xff, 0xff, 0xff, 0xff, 0xff, 0xff, 0xff, 0xff, 0xff, 0xff, 0xff,
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  0xff, 0xff, 0xff, 0xff, 0xff, 0xff, 0xff, 0xff, 0xff, 0xff, 0xff, 0xff, 0xff, 0xff, 0xff, 0xff
};


const unsigned char mycow4 [] PROGMEM = {
  // 'mycow4, 128x64px
  0xff, 0xff, 0xff, 0xff, 0xff, 0xff, 0xff, 0xff, 0xff, 0xff, 0xff, 0xff, 0xff, 0xff, 0xff, 0xff,
  0xff, 0xff, 0xff, 0xff, 0xff, 0xff, 0xff, 0xff, 0xff, 0xff, 0xff, 0xff, 0xff, 0xff, 0xff, 0xff,
  0xff, 0xff, 0xff, 0xff, 0xff, 0xff, 0xff, 0xff, 0xff, 0xff, 0xff, 0xff, 0xff, 0xff, 0xff, 0xff,
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  0xff, 0xff, 0xff, 0xff, 0xff, 0xff, 0xff, 0xff, 0xff, 0xff, 0xff, 0xff, 0xff, 0xff, 0xff, 0xff
};

const unsigned char mycow5 [] PROGMEM = {
  // 'mycow5, 128x64px
  0xff, 0xff, 0xff, 0xff, 0xff, 0xff, 0xff, 0xff, 0xff, 0xff, 0xff, 0xff, 0xff, 0xff, 0xff, 0xff,
  0xff, 0xff, 0xff, 0xff, 0xff, 0xff, 0xff, 0xff, 0xff, 0xff, 0xff, 0xff, 0xff, 0xff, 0xff, 0xff,
  0xff, 0xff, 0xff, 0xff, 0xff, 0xff, 0xff, 0xff, 0xff, 0xff, 0xff, 0xff, 0xff, 0xff, 0xff, 0xff,
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  0xff, 0xff, 0xff, 0xff, 0xff, 0xff, 0xff, 0xff, 0xff, 0xff, 0xff, 0xff, 0xff, 0xff, 0xff, 0xff
};

const unsigned char mycow6 [] PROGMEM = {
  // 'mycow6, 128x64px
  0xff, 0xff, 0xff, 0xff, 0xff, 0xff, 0xff, 0xff, 0xff, 0xff, 0xff, 0xff, 0xff, 0xff, 0xff, 0xff,
  0xff, 0xff, 0xff, 0xff, 0xff, 0xff, 0xff, 0xff, 0xff, 0xff, 0xff, 0xff, 0xff, 0xff, 0xff, 0xff,
  0xff, 0xff, 0xff, 0xff, 0xff, 0xff, 0xff, 0xff, 0xff, 0xff, 0xff, 0xff, 0xff, 0xff, 0xff, 0xff,
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  0xff, 0xff, 0xff, 0xff, 0xff, 0xff, 0xff, 0xff, 0xff, 0xff, 0xff, 0xff, 0xff, 0xff, 0xff, 0xff
};

const unsigned char mycow7 [] PROGMEM = {
  // 'mycow7, 128x64px
  0xff, 0xff, 0xff, 0xff, 0xff, 0xff, 0xff, 0xff, 0xff, 0xff, 0xff, 0xff, 0xff, 0xff, 0xff, 0xff,
  0xff, 0xff, 0xff, 0xff, 0xff, 0xff, 0xff, 0xff, 0xff, 0xff, 0xff, 0xff, 0xff, 0xff, 0xff, 0xff,
  0xff, 0xff, 0xff, 0xff, 0xff, 0xff, 0xff, 0xff, 0xff, 0xff, 0xff, 0xff, 0xff, 0xff, 0xff, 0xff,
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  0xff, 0xff, 0xff, 0xff, 0xff, 0xff, 0xff, 0xff, 0xff, 0xff, 0xff, 0xff, 0xff, 0xff, 0xff, 0xff
};

const unsigned char mycow8 [] PROGMEM = {
  // 'mycow8, 128x64px
  0xff, 0xff, 0xff, 0xff, 0xff, 0xff, 0xff, 0xff, 0xff, 0xff, 0xff, 0xff, 0xff, 0xff, 0xff, 0xff,
  0xff, 0xff, 0xff, 0xff, 0xff, 0xff, 0xff, 0xff, 0xff, 0xff, 0xff, 0xff, 0xff, 0xff, 0xff, 0xff,
  0xff, 0xff, 0xff, 0xff, 0xff, 0xff, 0xff, 0xff, 0xff, 0xff, 0xff, 0xff, 0xff, 0xff, 0xff, 0xff,
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  0xff, 0xff, 0xff, 0xff, 0xff, 0xff, 0xff, 0xff, 0xff, 0xff, 0xff, 0xff, 0xff, 0xff, 0xff, 0xff
};


const unsigned char putina_portret [] PROGMEM = {
  // 'putin, 128x64px
  0xff, 0xff, 0xff, 0xff, 0xff, 0xff, 0xff, 0xff, 0xff, 0xff, 0xff, 0xff, 0xff, 0xff, 0xff, 0xff,
  0xff, 0xff, 0xff, 0xff, 0xff, 0xff, 0xff, 0xff, 0xff, 0xff, 0xff, 0xff, 0xff, 0xff, 0xff, 0xff,
  0xff, 0xff, 0xff, 0xff, 0xff, 0xff, 0xff, 0xff, 0xff, 0xff, 0xff, 0xff, 0xff, 0xff, 0xff, 0xff,
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  0x00, 0x00, 0x00, 0x00, 0x00, 0x01, 0xfe, 0x00, 0x1b, 0xff, 0xe0, 0x00, 0x00, 0x00, 0x00, 0x1f
};

const unsigned char putina_portret_vtoroy [] PROGMEM = {
  // 'rian_6364945, 128x64px
  0xff, 0xff, 0xff, 0xff, 0xff, 0xff, 0xff, 0xff, 0xff, 0xff, 0xff, 0xff, 0xff, 0xff, 0xff, 0xff,
  0xf7, 0xbf, 0xff, 0xff, 0xff, 0xff, 0xfe, 0xad, 0x55, 0xff, 0xff, 0xfb, 0xef, 0x76, 0xdb, 0x6b,
  0xbd, 0xeb, 0x6d, 0xb6, 0xdb, 0x6d, 0xab, 0xff, 0xb6, 0xdb, 0x6d, 0xbe, 0xfb, 0xdf, 0xff, 0xfe,
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  0xb6, 0xae, 0xad, 0xda, 0xaa, 0xaa, 0xd6, 0xd7, 0x6d, 0x14, 0x27, 0xb5, 0x4a, 0xeb, 0xaf, 0xbd
};

const unsigned char rickrolled [] PROGMEM = {
  // 'rickroll, 128x64px
  0xff, 0xff, 0xff, 0xff, 0xff, 0xff, 0xff, 0xff, 0xff, 0xff, 0xff, 0xff, 0xff, 0xff, 0xff, 0xff,
  0xff, 0xff, 0xff, 0xff, 0xff, 0xff, 0xff, 0xff, 0xff, 0xff, 0xff, 0xff, 0xff, 0xff, 0xff, 0xff,
  0xff, 0xff, 0xff, 0xff, 0xff, 0xff, 0xff, 0xff, 0xff, 0xff, 0xff, 0xff, 0xff, 0xff, 0xff, 0xff,
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  0xff, 0xff, 0xff, 0xff, 0xff, 0x00, 0x00, 0x00, 0x00, 0x00, 0x00, 0x39, 0xff, 0xff, 0xff, 0xff
};

const unsigned char bread [] PROGMEM = {
  // 'bread, 25x25px
  0x00, 0x08, 0x00, 0x00, 0x00, 0x1c, 0x00, 0x00, 0x60, 0x0c, 0x00, 0x00, 0xf0, 0x00, 0x00, 0x00,
  0x62, 0x00, 0xf0, 0x00, 0x07, 0x07, 0xfe, 0x00, 0x02, 0x1f, 0xcf, 0x00, 0x00, 0x3e, 0x07, 0x80,
  0x03, 0xfe, 0x07, 0x80, 0x07, 0xf7, 0x83, 0x80, 0x0f, 0xf3, 0xe1, 0x80, 0x0f, 0x38, 0x71, 0x80,
  0x1f, 0x1c, 0x38, 0x80, 0x1f, 0x8f, 0x18, 0x80, 0x3f, 0xe3, 0x83, 0x80, 0x39, 0xf3, 0xc7, 0x00,
  0x38, 0xf9, 0xcf, 0x00, 0x3c, 0x38, 0xc6, 0x00, 0x1c, 0x00, 0x1e, 0x00, 0x0f, 0x81, 0xfc, 0x00,
  0x07, 0xff, 0xf8, 0x00, 0x21, 0xfe, 0x00, 0x00, 0x70, 0x00, 0x00, 0x00, 0x20, 0x00, 0x00, 0x00,
  0x00, 0x00, 0x00, 0x00
};

const unsigned char cat [] PROGMEM = {
  // 'cat, 25x25px
  0x00, 0x00, 0x00, 0x00, 0x00, 0x00, 0x00, 0x00, 0x18, 0x00, 0x00, 0x00, 0x1e, 0x00, 0x1c, 0x00,
  0x13, 0x80, 0x36, 0x00, 0x18, 0xf1, 0xe6, 0x00, 0x1b, 0xff, 0xe6, 0x00, 0x0f, 0x80, 0x36, 0x00,
  0x0c, 0x00, 0x1c, 0x00, 0x0c, 0x00, 0x1f, 0x00, 0x0c, 0xa2, 0x9f, 0x80, 0x04, 0xe3, 0x91, 0x80,
  0x04, 0x08, 0x30, 0x80, 0x06, 0x00, 0x30, 0x80, 0x02, 0x38, 0x20, 0x80, 0x03, 0x24, 0x60, 0x80,
  0x03, 0x80, 0xc0, 0x00, 0x01, 0x81, 0x80, 0x00, 0x01, 0xff, 0x00, 0x00, 0x00, 0x7c, 0x00, 0x80,
  0x00, 0x79, 0x00, 0x80, 0x00, 0x39, 0x86, 0x80, 0x00, 0x13, 0x09, 0x80, 0x00, 0x0e, 0x4b, 0x80,
  0x00, 0x0c, 0x83, 0x80
};



const unsigned char blow [] PROGMEM = {
  // 'blow, 8x8px
  0x82, 0x28, 0x0e, 0xa4, 0x1b, 0x56, 0x28, 0x85
};

const unsigned char blow1 [] PROGMEM = {
  // 'blow1, 8x8px
  0x82, 0x38, 0x6d, 0xa4, 0x7a, 0x5e, 0x2c, 0x01
};

const unsigned char gunlet [] PROGMEM = {
  // 'gunlet, 8x8px
  0x7e, 0xeb, 0xb9, 0xc3, 0x7e, 0x3c, 0x18, 0x18
};

const unsigned char gunlet1 [] PROGMEM = {
  // 'gunlet1, 8x8px
  0x76, 0xcb, 0xa9, 0xc3, 0x26, 0x34, 0x9a, 0x1a
};

const unsigned char impostor [] PROGMEM = {
  // 'burjui, 8x8px
  0x24, 0xa5, 0xa5, 0xff, 0xdb, 0x24, 0x18, 0x18
};

const unsigned char fighter [] PROGMEM = {
  // 'fighter, 8x8px
  0x00, 0x18, 0x08, 0x99, 0xff, 0xbd, 0xdb, 0x81
};

const unsigned char piano_logo [] PROGMEM = {
  0x03, 0xff, 0xff, 0xf0, 0x00, 0x0e, 0x00, 0x00, 0x1c, 0x00, 0x18, 0x00, 0x00, 0x06, 0x00, 0x30,
  0x00, 0x00, 0x03, 0x00, 0x60, 0x00, 0x00, 0x01, 0x80, 0x40, 0x00, 0x00, 0x00, 0x80, 0xc0, 0x00,
  0x00, 0x00, 0xc0, 0x80, 0x00, 0x00, 0x00, 0x40, 0xfe, 0x3f, 0x1f, 0x1f, 0xc0, 0xfe, 0x3f, 0x1f,
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  0x0f, 0x7f, 0xbf, 0xbc, 0x00, 0x03, 0xff, 0xff, 0xf0, 0x00
};

const unsigned char phisics_logo [] PROGMEM = {
  // 'phisics, 34x34px
  0x03, 0xff, 0xff, 0xf0, 0x00, 0x0e, 0x00, 0x00, 0x1c, 0x00, 0x18, 0x00, 0x00, 0x06, 0x00, 0x30,
  0x00, 0x00, 0x03, 0x00, 0x60, 0x00, 0x00, 0x01, 0x80, 0x40, 0x02, 0x00, 0x00, 0x80, 0xc0, 0x02,
  0x00, 0x00, 0xc0, 0x81, 0xd3, 0xe1, 0xe0, 0x40, 0x83, 0xf3, 0xf3, 0xf0, 0x40, 0x82, 0x12, 0x12,
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  0x0e, 0x00, 0x00, 0x1c, 0x00, 0x03, 0xff, 0xff, 0xf0, 0x00
};

const unsigned char cat_or_bread_logo [] PROGMEM = {
  // 'cat_or_bread, 34x34px
  0x03, 0xff, 0xff, 0xf0, 0x00, 0x0e, 0x00, 0x00, 0x1c, 0x00, 0x18, 0x3e, 0x01, 0x06, 0x00, 0x30,
  0x60, 0x01, 0x03, 0x00, 0x60, 0x40, 0x73, 0x81, 0x80, 0x40, 0x40, 0x51, 0x00, 0x80, 0xc0, 0x40,
  0x99, 0x00, 0xc0, 0x80, 0x60, 0xd9, 0x00, 0x40, 0x80, 0x1e, 0x79, 0x00, 0x40, 0x80, 0x00, 0x00,
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  0x0e, 0x00, 0x00, 0x1c, 0x00, 0x03, 0xff, 0xff, 0xf0, 0x00
};

const unsigned char tanchiki_logo [] PROGMEM = {
  // 'tanchiki, 34x34px
  0x03, 0xff, 0xff, 0xf0, 0x00, 0x0e, 0x00, 0x00, 0x1c, 0x00, 0x18, 0x7f, 0xfc, 0x06, 0x00, 0x30,
  0x58, 0x34, 0x13, 0x00, 0x60, 0x77, 0xfc, 0x01, 0x80, 0x44, 0x55, 0x74, 0x00, 0x80, 0xc0, 0x77,
  0xfc, 0x00, 0xc0, 0xe0, 0x53, 0xb4, 0x20, 0x40, 0x80, 0x73, 0xbc, 0x00, 0x40, 0x80, 0x51, 0x34,
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  0x01, 0xff, 0xff, 0xe0, 0x00, 0x00, 0x00, 0x00, 0x00, 0x00
};


const unsigned char space_heroes_logo [] PROGMEM = {
  // 'sapce_heroes, 34x34px
  0x03, 0xff, 0xff, 0xf0, 0x00, 0x0e, 0x00, 0x00, 0x1c, 0x00, 0x18, 0x90, 0x00, 0x06, 0x00, 0x32,
  0x94, 0x00, 0x03, 0x00, 0x62, 0x94, 0x00, 0x01, 0x80, 0x43, 0xfc, 0x00, 0x90, 0x80, 0xc3, 0x6c,
  0x02, 0x94, 0xc0, 0x80, 0x90, 0x02, 0x94, 0x40, 0x80, 0x64, 0x13, 0xfc, 0x40, 0x80, 0x61, 0xc3,
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  0x0e, 0x00, 0x00, 0x1c, 0x00, 0x03, 0xff, 0xff, 0xf0, 0x00
};

const unsigned char thermometer_logo [] PROGMEM = {
  // 'thermometer, 34x34px
  0x03, 0xff, 0xff, 0xf0, 0x00, 0x0e, 0x00, 0x0b, 0xdc, 0x00, 0x18, 0x00, 0x07, 0xfe, 0x00, 0x30,
  0x12, 0x00, 0xff, 0x00, 0x60, 0x38, 0x00, 0x01, 0x80, 0x40, 0x10, 0x00, 0x00, 0x80, 0xc0, 0x10,
  0x00, 0x00, 0xc0, 0x80, 0x18, 0x00, 0x00, 0x40, 0x80, 0x00, 0x00, 0x00, 0x40, 0x86, 0x00, 0x07,
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  0x0f, 0xff, 0xff, 0x9c, 0x00, 0x03, 0xff, 0xff, 0xf0, 0x00
};

const unsigned char lambda_logo [] PROGMEM = {
  // 'lambda, 34x34px
  0x03, 0xff, 0xff, 0xf0, 0x00, 0x0e, 0x00, 0x00, 0x1c, 0x00, 0x18, 0x00, 0x00, 0x06, 0x00, 0x30,
  0x00, 0x00, 0x03, 0x00, 0x60, 0x7f, 0x00, 0x01, 0x80, 0x40, 0x7f, 0x80, 0x00, 0x80, 0xc0, 0x7f,
  0xc0, 0x00, 0xc0, 0x80, 0x0f, 0xe0, 0x00, 0x40, 0x80, 0x07, 0xe0, 0x00, 0x40, 0x80, 0x03, 0xf0,
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  0x0e, 0x00, 0x00, 0x1c, 0x00, 0x03, 0xff, 0xff, 0xf0, 0x00
};

const unsigned char beer_logo [] PROGMEM = {
  0x03, 0xff, 0xff, 0xf0, 0x00, 0x0e, 0x00, 0x00, 0x1c, 0x00, 0x18, 0x00, 0x00, 0x06, 0x00, 0x30,
  0x00, 0x00, 0x03, 0x00, 0x60, 0x00, 0x00, 0x01, 0x80, 0x40, 0x00, 0x00, 0x00, 0x80, 0xde, 0x79,
  0xe7, 0x90, 0xc0, 0x9a, 0x69, 0xa6, 0xd0, 0x40, 0x9a, 0x61, 0x86, 0x87, 0x40, 0x9e, 0x71, 0xc7,
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  0x0e, 0x00, 0x00, 0x1c, 0x00, 0x03, 0xff, 0xff, 0xf0, 0x00
};

const unsigned char terminal_logo [] PROGMEM = {
  // 'cutecom, 34x34px
  0x03, 0xff, 0xff, 0xf0, 0x00, 0x0e, 0x00, 0x00, 0x1c, 0x00, 0x18, 0x00, 0x00, 0x06, 0x00, 0x30,
  0x00, 0x00, 0x03, 0x00, 0x60, 0x00, 0x00, 0x01, 0x80, 0x40, 0x00, 0x00, 0x00, 0x80, 0xc0, 0x00,
  0x00, 0x00, 0xc0, 0x80, 0x00, 0x00, 0x00, 0x40, 0x80, 0x00, 0x00, 0x00, 0x40, 0x80, 0x00, 0x00,
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  0x0e, 0x00, 0x00, 0x1c, 0x00, 0x03, 0xff, 0xff, 0xf0, 0x00
};

const unsigned char WiFi_logo [] PROGMEM = {
  // 'wifi-2, 58x40px
  0xff, 0xff, 0xff, 0xff, 0xff, 0xff, 0xff, 0xc0, 0xff, 0xff, 0xfe, 0x00, 0x1f, 0xff, 0xff, 0xc0, 
  0xff, 0xff, 0xf0, 0x00, 0x03, 0xff, 0xff, 0xc0, 0xff, 0xff, 0xe0, 0x00, 0x00, 0xff, 0xff, 0xc0, 
  0xff, 0xff, 0x80, 0x00, 0x00, 0x7f, 0xff, 0xc0, 0xff, 0xff, 0x00, 0x00, 0x00, 0x3f, 0xff, 0xc0, 
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  0xff, 0xff, 0xfc, 0x00, 0x0f, 0xff, 0xff, 0xc0, 0xff, 0xff, 0xff, 0xc0, 0xff, 0xff, 0xff, 0xc0
};


const unsigned char *cow[8] PROGMEM = {mycow1, mycow2, mycow3, mycow4, mycow5, mycow6, mycow7, mycow8};

const char *settings[] = {"music", "cat or bread delay", "Medic_thermometer", "ROM-tool (password)", "About device"};
const char *keys[] = {"KEY1", "KEY2", "KEY3", "KEY4"};
const char *note_names[] = {"ДО", "РЕ", "МИ", "ФА", "СОЛЬ", "ЛЯ", "СИ", "ДО2"};
const int notes[] = {261, 293, 329, 349, 392, 440, 493, 526};

const char *comedy_text[]  =
{ "Божественная комедия:\n1 Земную жизнь пройдя до половины,\nЯ очутился в сумрачном лесу,\nУтратив правый путь во тьме долины.",
  "4 Каков он был, о, как произнесу,\nТот дикий лес, дремучий и грозящий,\nЧей давний ужас в памяти несу!",
  "7 Так горек он, что смерть едва ль не слаще.\nНо, благо в нем обретши навсегда,\nСкажу про все, что видел в этой чаще.",
  "10 Не помню сам, как я вошел туда,\nНастолько сон меня опутал ложью,\nКогда я сбился с верного следа.",
  "13 Но к холмному приблизившись подножью,\nКоторым замыкался этот дол,\nМне сжавший сердце ужасом и дрожью,",
  "16 Я увидал, едва глаза возвел,\nЧто свет планеты, всюду путеводной,\nУже на плечи горные сошел.",
  "19 Тогда вздохнула более свободной\nИ долгий страх превозмогла душа,\nИзмученная ночью безысходной.",
  "22 И словно тот, кто, тяжело дыша,\nНа берег выйдя из пучины пенной,\nГлядит назад, где волны бьют, страша,",
  "25 Так и мой дух, бегущий и смятенный,\nВспять обернулся, озирая путь,\nВсех уводящий к смерти предреченной."
};

void(* resetFunc) (void) = 0;

int firststep = 0;
int steps = 0;
byte rbtnr = 1;
byte rbtnl = 1;
byte fwdbtn = 1;
byte shtbtn = 1;
int gxb = 15;
int gyb = 7;
int grb = 3;
int gxw = 0;
int gyw = 0;
int grw = 1;
int lastx;
int lasty;
byte rngb = 5;
byte rngw = 5;

byte carta[16][8];

int gameNum = 0;

int laserTime = 0;
int laserX;
int blowNum = 1;
int fighterX = 0;
int impostorX = 0;
int impostorY = 0;
int shootY = 52;
int shootX;
byte blown = 0;
long int laserTimer = 0;
long int cooldown = 0;
long int killDelay = 0;
long int atackTimer = 0;
int impostorExit;
int score = 0;
int rockets = 0;
int rocketScore = 0;
int doorFrame;
int torpedaX;
int torpedaY;
int gone = 0;
byte gamemode = 0;
byte gun1State = 0;
byte gun2State = 0;
byte gun3State = 0;


int hard = 1000;
int table[4];
int catsCountK;
int hardFall;
long int kIncreaseTimer = 0;
long int hardFallTimer = 0;
int count = 0;

long int timer = 0;
int dead = 2;

void wait() {
  delay(1000000 * EEPROM.read(65) + 5000);
  ESP.restart();
}
/*
  void setup1() {
  pinMode(25, OUTPUT);
  }

  void loop1() {
  delay(200);
  midi();
  }
*/

String utf8rus(String source)
{
  int i, k;
  String target;
  unsigned char n;
  char m[2] = { '0', '\0' };
  k = source.length(); i = 0;
  while (i < k) {
    n = source[i]; i++;
    if (n >= 0xC0) {
      switch (n) {
        case 0xD0: {
            n = source[i]; i++;
            if (n == 0x81) {
              n = 0xA8;
              break;
            }
            if (n >= 0x90 && n <= 0xBF) n = n + 0x30;
            break;
          }
        case 0xD1: {
            n = source[i]; i++;
            if (n == 0x91) {
              n = 0xB8;
              break;
            }
            if (n >= 0x80 && n <= 0x8F) n = n + 0x70;
            break;
          }
      }
    }
    m[0] = n; target = target + String(m);
  }
  return target;
}



bool thermo_type = 1;

void gamMenu() {
  int btn0 = !BTN;
  int btn2 = !BTN;
  int btn3 = !BTN;
  int mapnum = 0;
  int enter = 0;
  while (enter == BTN) {
    display.clearDisplay();
    display.setCursor(0, 3);
    display.setTextSize(2);
    display.print(utf8rus("  Выбирай"));
    switch (mapnum) {
      case 0:
        display.drawBitmap(47, 23, space_heroes_logo, 34, 34, 1);
        break;
      case 1:
        display.drawBitmap(47, 23, cat_or_bread_logo, 34, 34, 1);
        break;
      case 2:
        display.drawBitmap(47, 23, tanchiki_logo, 34, 34, 1);
        break;
      case 3:
        display.drawBitmap(47, 23, phisics_logo, 34, 34, 1);
        break;
      case 4:
        display.setCursor(0, 30);
        display.print(utf8rus("  Портрет_путина.png"));
        break;
      case 5:
        display.setCursor(2, 30);
        display.print(utf8rus("Корова.mp4"));
        break;
      case 6:
        display.setCursor(2, 30);
        display.print(utf8rus(" Настройки"));
        break;
      case 7:
        display.drawBitmap(47, 23, lambda_logo, 34, 34, 1);
        break;
      case 8:
        display.drawBitmap(47, 23, beer_logo, 34, 34, 1);
        break;
      case 9:
        display.drawBitmap(47, 23, terminal_logo, 34, 34, 1);
        break;

    }
    display.drawRect(0, 0, 128, 64 , 1);
    display.display();
    while (btn0 == !BTN && btn2 == !BTN && btn3 == !BTN) {
      btn0 = digitalRead(KEYLS);
      btn2 = digitalRead(KEYRC);
      btn3 = digitalRead(KEYRS);
    }
    if (btn0 == BTN) {
      mapnum--;
      if (mapnum < 0) {
        mapnum = APPS - 1;
      }
      btn0 = !BTN;
      delay(200);
    }
    else {
      if (btn2 == BTN) {
        mapnum++;
        if (mapnum > APPS - 1) {
          mapnum = 0;
        }
        btn2 = !BTN;
        delay(200);
      }
      else {
        if (btn3 == BTN) {
          enter = 1;
          btn3 = !BTN;
          delay(200);
        }
      }
    }

  }
  btn0 = !BTN;
  btn2 = !BTN;
  btn3 = !BTN;
  delay(300);
  display.clearDisplay();
  if (enter == 1) {
    if (mapnum == 0) {
      playSpace();
    }
    else if (mapnum == 1) {
      playCats();
    }
    else if (mapnum == 2) {
      playMetaBalls();
      playTanks();
    }
    else if (mapnum == 3) {
      playPhisics();
    }
    else if (mapnum == 4) {
      playPiano();
      display.clearDisplay();
      display.drawBitmap(0, 0, putina_portret, 128, 64, 1);
      display.display();
      delay(3000);
      display.clearDisplay();
      display.drawBitmap(0, 0, putina_portret_vtoroy, 128, 64, 1);
      display.display();
    }
    else if (mapnum == 5) {
      //rp2040.resumeOtherCore();
      
      while (1) {
        for (byte i = 0; i < 8; i++) {
          display.clearDisplay();
          display.drawBitmap(0, 0, cow[i], 128, 64, 1);
          display.display();
          delay(230);
        }
      }
    }
    else if (mapnum == 6) {
      playSettings();
    }
    else if (mapnum == 7) {        // Если пользователь выберет 10 приложение
      play3d();             // Запустим наше
    }
    else if (mapnum == 8) {
      playBeer();
    }
    else if (mapnum == 9) {
      playKatafalk();
      //playFilm();
    }
  }


}



IPAddress IP;

void setup() {
  ledcSetup(0, 0, 8);
  ledcAttachPin(5, 0);
  ledcWrite(0, 125);
  EEPROM.begin(256);
  Wire.setClock(800000);
  Wire.begin(18, 19);
  pinMode(KEYLS, INPUT_PULLUP);
  pinMode(KEYLC, INPUT_PULLUP);
  pinMode(KEYRC, INPUT_PULLUP);
  pinMode(KEYRS, INPUT_PULLUP);
  ledcSetup(TONEPIN, 300, 255);
  randomSeed(analogRead(36));
  display.begin(SSD1306_SWITCHCAPVCC, 0x3C);
  display.dim(0);
  display.cp437(true);
  display.setRotation(0);
  display.fillScreen(0);
  display.setTextColor(1, 0);
  display.clearDisplay();
  if (!digitalRead(KEYOTA)) {
    display.setTextSize(1);
    display.setCursor(5, 5);
    display.print("  Firmware upload!");
    display.setCursor(5, 45);
    display.println("Connecting to ");
    display.print(ssid);
    display.display();
    WiFi.mode(WIFI_STA);
    WiFi.begin(ssid, password);
    while (WiFi.status() != WL_CONNECTED) {
      delay(100);
    }
    IP = WiFi.localIP();

    ArduinoOTA
    .onStart([]() {
      String type;
      if (ArduinoOTA.getCommand() == U_FLASH)
        type = "sketch";
      else // U_SPIFFS
        type = "filesystem";

      // NOTE: if updating SPIFFS this would be the place to unmount SPIFFS using SPIFFS.end()
      Serial.println("Start updating " + type);
    })
    .onEnd([]() {
      Serial.println("\nEnd");
    })
    .onProgress([](unsigned int progress, unsigned int total) {
      Serial.printf("Progress: %u%%\r", (progress / (total / 100)));
    })
    .onError([](ota_error_t error) {
      Serial.printf("Error[%u]: ", error);
      if (error == OTA_AUTH_ERROR) Serial.println("Auth Failed");
      else if (error == OTA_BEGIN_ERROR) Serial.println("Begin Failed");
      else if (error == OTA_CONNECT_ERROR) Serial.println("Connect Failed");
      else if (error == OTA_RECEIVE_ERROR) Serial.println("Receive Failed");
      else if (error == OTA_END_ERROR) Serial.println("End Failed");
    });

    ArduinoOTA.begin();

    display.clearDisplay();
    display.setCursor(5, 5);
    display.print("  Firmware upload!");
    display.setCursor(5, 45);
    display.print("IP: ");
    display.print(IP);
    display.display();
    while (1) ArduinoOTA.handle();
  }

  gamMenu();
  display.clearDisplay();

}

void loop() {

}

byte korobkaMenu(byte lenght, const char *elements[]) {
  int mapnum = 0;
  while (1) {
    display.clearDisplay();
    display.setTextSize(1);
    display.setCursor(0, 0);
    for (byte i = 0; i < lenght; i++) {

      display.print("  ");
      display.println(utf8rus(elements[i]));
    }
    display.setCursor(0, 8 * mapnum);
    display.print(">");
    display.display();
    bool up = !BTN;
    bool down = !BTN;
    bool enter = !BTN;
    while (up == !BTN and down == !BTN and enter == !BTN) {
      up = digitalRead(KEYLS);
      down = digitalRead(KEYRC);
      enter = digitalRead(KEYRS);
    }
    if (up == BTN) mapnum--; if (mapnum < 0) mapnum = lenght - 1; delay(100);
    if (down == BTN) mapnum++; if (mapnum > lenght - 1) mapnum = 0; delay(100);
    if (enter  == BTN) break;
  }
  delay(200);
  return mapnum;
}

int korobkaInput(int mini, int maxi, int stepi, int def) {
  int mapnum = def;
  while (1) {
    display.clearDisplay();
    display.setTextSize(2);
    display.drawRoundRect(15, 15, 98, 25, 5, 1);
    display.setCursor(19, 19);
    display.print(mapnum);
    display.display();
    bool up = !BTN;
    bool down = !BTN;
    bool enter = !BTN;
    while (up == !BTN and down == !BTN and enter == !BTN) {
      up = digitalRead(KEYLS);
      down = digitalRead(KEYRC);
      enter = digitalRead(KEYRS);
    }
    if (up == BTN) mapnum -= stepi; if (mapnum < mini) mapnum = maxi - 1; delay(100);
    if (down == BTN) mapnum += stepi; if (mapnum > maxi - 1) mapnum = mini; delay(100);
    if (enter == BTN) break;
  }
  delay(200);
  return mapnum;
}

bool writeInt(int addr, int data) {
  EEPROM.write(addr, data / 256);
  EEPROM.write(addr + 1, data % 256);
  return EEPROM.commit();
}

int readInt(int addr) {
  return EEPROM.read(addr) * 256 + EEPROM.read(addr + 1);
}

void playSettings() {
  while (1) {
    switch (korobkaMenu(5, settings)) {
      case 0: {
          byte key = korobkaMenu(4, keys);
          int freq = notes[korobkaMenu(8, note_names)];
          writeInt(key * 2 + 4, freq);
          message("Saved!", 400);
          break;
        }
      case 1: {
          int count = korobkaInput(80, 401, 5, readInt(2));
          writeInt(2, count);
          message("Saved!", 400);
          break;
        }
      case 2: {
          thermo_type = 0;
          //playThermometer();
          break;
        }
      case 3: {
          if (korobkaInput(0, 1000, 10, 500) == ROM_PASSWD) {
            message("pass OK!", 400);
            message("ROM addr:", 400);
            int addr = korobkaInput(0, 256, 1, 0);
            message("Data:", 400);
            EEPROM.write(addr, korobkaInput(0, 256, 1, EEPROM.read(addr)));
            EEPROM.commit();
            message("Saved!", 400);
          }
          else {
            message("wrong pass", 400);
          }

          break;
        }
      case 4: {
        display.clearDisplay();
        display.setCursor(0, 0);
        display.setTextSize(1);
        WiFi.mode(WIFI_MODE_STA);
        display.println(WiFi.macAddress());
        display.display();
        while(1);
        break;
        
      }

    }
  }
}

void message(char* mes, int dlay) {
  display.clearDisplay();
  display.setCursor(0, 0);
  display.setTextSize(2);
  display.print(utf8rus(mes));
  display.display();
  delay(dlay);
}

void korobkaReader(const char* file[], int lenght) {
  display.clearDisplay();
  display.setTextSize(1);
  display.setCursor(0, 0);
  display.print(F("KorobkaReader 1.0\nis loading..."));
  display.display();
  delay(150);
  int mapnum = 0;
  while (1) {
    display.clearDisplay();
    display.setCursor(0, 0);
    display.print(utf8rus(file[mapnum]));
    display.display();
    bool up = !BTN;
    bool down = !BTN;
    while (up == !BTN and down == !BTN) {
      up = digitalRead(KEYLS);
      down = digitalRead(KEYRC);
    }
    if (up == BTN) mapnum --; if (mapnum < 0) mapnum = lenght - 1; delay(100);
    if (down == BTN) mapnum ++; if (mapnum > lenght - 1) mapnum = 0; delay(100);
    delay(200);
  }
}
